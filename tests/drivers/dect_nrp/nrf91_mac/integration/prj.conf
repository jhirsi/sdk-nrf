## CMakeLists.txt
```
# SPDX-License-Identifier: Apache-2.0
# Copyright (c) 2025 Nordic Semiconductor ASA
# DECT NR+ Stack Integration Tests with Unity and CMock

cmake_minimum_required(VERSION 3.20.0)

# Use our custom Kconfig for test-specific configuration
set(KCONFIG_ROOT ${CMAKE_CURRENT_SOURCE_DIR}/Kconfig)

find_package(Zephyr REQUIRED HINTS $ENV{ZEPHYR_BASE})
project(dect_nrp_integration_test)

# Unity Test Framework is provided by CONFIG_UNITY=y in prj.conf and Nordic SDK
# CMock headers are included but implementations come from Nordic SDK

# Add test source files for Unity-based integration testing
# Test source files
target_sources(app PRIVATE
    src/main.c
    src/test_dect_integration.c
    src/test_dect_utils.c
    src/mocks/mock_nrf_modem_dect_mac.c
)

# The DECT L2 subsystem is now included automatically via Zephyr modules
# when CONFIG_NET_L2_DECT_MGMT=y is enabled in prj.conf
# No need to manually add the source files

# Include all necessary directories for DECT stack
target_include_directories(app PRIVATE
    ${CMAKE_CURRENT_SOURCE_DIR}/src/mocks
    ${ZEPHYR_BASE}/../nrfxlib/nrf_modem/include
    ${ZEPHYR_BASE}/../nrfxlib/common/include
    ${ZEPHYR_BASE}/../nrf/drivers/dect_nrp/nrf91_mac
    ${ZEPHYR_BASE}/../nrf/subsys/net/l2_dect_nrp/include
    ${ZEPHYR_BASE}/../nrf/include/net
    ${ZEPHYR_BASE}/include/zephyr/net
    ${ZEPHYR_BASE}/subsys/net/ip
)

# Add nrfxlib include directories globally so DECT stack can find headers
target_include_directories(zephyr_interface INTERFACE
    ${ZEPHYR_BASE}/../nrfxlib/nrf_modem/include
    ${ZEPHYR_BASE}/../nrfxlib/common/include
)

# All CONFIG values are now properly defined in Kconfig
# No need for manual compile definitions

# Unity and CMock libraries are provided by Nordic SDK modules

# Add custom target for coverage report generation
if(CONFIG_COVERAGE)
    add_custom_target(coverage_report
        COMMAND ${CMAKE_CURRENT_SOURCE_DIR}/generate_coverage.sh
        WORKING_DIRECTORY ${CMAKE_CURRENT_SOURCE_DIR}
        COMMENT "Generating DECT NR+ stack coverage report"
        DEPENDS app
    )
endif()
```

## Kconfig
```
# SPDX-License-Identifier: Apache-2.0
# Copyright (c) 2025 Nordic Semiconductor ASA
#
# Kconfig for DECT NR+ Integration Tests
# Provides minimal definitions needed for DECT stack compilation without full modem library

# Define NRF_MODEM_VARIANT_DECT_MAC for DECT driver compilation
# This is normally defined by the nrf_modem library, but we mock all modem functions
config NRF_MODEM_VARIANT_DECT_MAC
	bool "DECT MAC modem variant for testing"
	default y
	help
	  Mock definition of NRF_MODEM_VARIANT_DECT_MAC for DECT driver compilation.
	  This allows the DECT drivers to compile without requiring the actual modem library.
	  All nrf_modem_dect_mac.h functions are mocked in the test implementation.

# Enable SETTINGS support needed by DECT drivers
config SETTINGS
	bool "Settings subsystem"
	default y
	help
	  Settings support needed by DECT drivers.

# Define DECT_NRP_LIB that is selected by DECT drivers
config DECT_NRP_LIB
	bool "DECT NR+ Library support"
	default y
	help
	  Mock DECT NR+ library configuration for testing.
	  In real builds this would pull in nrfxlib components.

# Modem shared memory configurations needed by MAC drivers
config NRF_MODEM_LIB_SHMEM_TX_SIZE
	int "Modem shared memory TX size"
	default 12288
	help
	  Mock definition for modem shared memory TX size.
	  Used by MAC driver for validation.

config NRF_MODEM_LIB_SHMEM_RX_SIZE
	int "Modem shared memory RX size"
	default 6144
	help
	  Mock definition for modem shared memory RX size.
	  Used by MAC driver for validation.

config NRF_MODEM_SHMEM_CTRL_SIZE
	hex "Modem shared memory control size"
	default 0x4e8
	help
	  Mock definition for modem shared memory control size.
	  Used by MAC driver for validation.

# Most modem CONFIG values are already defined in the main SDK
# We only need to ensure they have reasonable defaults for testing
# The values will be set in prj.conf

source "Kconfig.zephyr"
```

## prj.conf
```kconfig
# DECT NR+ Stack Integration Test Configuration for native_sim
# Tests complete stack from net_mgmt API to mocked libmodem

# Unity Test Framework
CONFIG_UNITY=y

# Code Coverage Support (for native_sim) - focus on DECT stack
# Disabled by default - enable when running coverage measurement
# The generate_coverage.sh script automatically enables these temporarily
#CONFIG_COVERAGE=y
#CONFIG_COVERAGE_NATIVE_GCOV=y

# Basic configuration for Unity testing on native_sim
CONFIG_TEST=y
CONFIG_ZTEST=n

# System configuration for DECT stack testing
CONFIG_MAIN_STACK_SIZE=8192
CONFIG_SYSTEM_WORKQUEUE_STACK_SIZE=4096

# Networking configuration for DECT integration testing
# Note: CONFIG_NRF_MODEM_LIB is NOT enabled - all modem functions are mocked
CONFIG_NETWORKING=y
CONFIG_NET_NATIVE=y
CONFIG_NET_IPV4=n
CONFIG_NET_IPV6=y
CONFIG_NET_MGMT=y
CONFIG_NET_MGMT_EVENT=y
CONFIG_NET_MGMT_EVENT_INFO=y
CONFIG_NET_MGMT_EVENT_INFO_DEFAULT_DATA_SIZE=208

# DECT L2 layer
CONFIG_NET_L2_DECT=y

# Note: Modem library CONFIG values are mocked via compile definitions in CMakeLists.txt

# DECT NR+ specific configurations with full MAC driver stack
CONFIG_DECT_NRP_MAC=y
CONFIG_DECT_NRP_MAC_DRIVER_NRF=y
CONFIG_DECT_NRP_MAC_CLUSTER_MAX_CHILD_ASSOCIATION_COUNT=8
CONFIG_DECT_NRP_MAC_LOG_LEVEL_INF=y
CONFIG_DECT_NRP_MAC_DEVICE_NAME="dect_test"
CONFIG_DECT_NRP_MAC_NET_IF_NO_AUTO_START=n

# Modem shared memory configuration (defined in Kconfig)

# DECT L2 networking layer
CONFIG_NET_L2_DECT_MGMT=y
CONFIG_NET_L2_DECT_LOG_LEVEL_INF=y
CONFIG_NET_L2_DECT_MGMT_LOG_LEVEL_INF=y

CONFIG_NET_LOG=y

# Suppress informational messages from DECT Bearer layer (like "Ethernet interface found")
CONFIG_NET_L2_DECT_BR_LOG_LEVEL_INF=n
CONFIG_NET_L2_DECT_BR_LOG_LEVEL_WRN=y

# Network management event logging
CONFIG_NET_MGMT_EVENT_LOG_LEVEL_INF=y

# Disable Ethernet L2 layer (not needed for DECT MAC testing)
CONFIG_NET_L2_ETHERNET=n
CONFIG_NET_L2_ETHERNET=n
CONFIG_ETH_NATIVE_POSIX=n

# Note: DECT stack is included manually via CMakeLists.txt sources
# This allows testing the complete stack with mocked nrf_modem_dect_mac.h

CONFIG_NET_INTERFACE_NAME=y
CONFIG_NET_INTERFACE_NAME_LEN=15
CONFIG_NET_IF_MAX_IPV6_COUNT=2

# Network buffers
CONFIG_NET_BUF=y
CONFIG_NET_BUF_DATA_SIZE=128
CONFIG_NET_BUF_POOL_USAGE=y
CONFIG_NET_PKT_RX_COUNT=15
CONFIG_NET_BUF_RX_COUNT=30
CONFIG_NET_PKT_TX_COUNT=15
CONFIG_NET_BUF_TX_COUNT=30

# Network stack sizes
CONFIG_NET_TX_STACK_SIZE=2048
CONFIG_NET_RX_STACK_SIZE=2048
CONFIG_NET_MGMT_EVENT_STACK_SIZE=2048
CONFIG_NET_MGMT_EVENT_QUEUE_SIZE=10
CONFIG_NET_MGMT_EVENT_QUEUE_TIMEOUT=5000

# Network context support
CONFIG_NET_CONTEXT_SNDTIMEO=y
CONFIG_NET_CONTEXT_RCVTIMEO=y

# System configuration
CONFIG_MAIN_STACK_SIZE=8192
CONFIG_SYSTEM_WORKQUEUE_STACK_SIZE=3072
CONFIG_HEAP_MEM_POOL_SIZE=25600

# Logging and debugging - Use DEFERRED mode to avoid threading issues
CONFIG_ASSERT=y
CONFIG_LOG=y
CONFIG_PRINTK=y
CONFIG_LOG_PRINTK=y
CONFIG_LOG_MODE_DEFERRED=y
CONFIG_LOG_DEFAULT_LEVEL=3
CONFIG_DEBUG_INFO=y
CONFIG_ASSERT_VERBOSE=y
CONFIG_RESET_ON_FATAL_ERROR=n

# Enhanced logging for threading visibility - now enabled for DEFERRED mode
CONFIG_LOG_BUFFER_SIZE=4096
CONFIG_LOG_PROCESS_TRIGGER_THRESHOLD=10
CONFIG_LOG_PROCESS_THREAD_STACK_SIZE=2048
CONFIG_LOG_PROCESS_THREAD_STARTUP_DELAY_MS=0

# Thread debugging support
CONFIG_THREAD_NAME=y

# Kernel options
CONFIG_ENTROPY_GENERATOR=y

# Settings for state persistence
CONFIG_FLASH=y
CONFIG_FLASH_MAP=y
CONFIG_MPU_ALLOW_FLASH_WRITE=y
CONFIG_NVS=y
CONFIG_SETTINGS=y
CONFIG_SETTINGS_NVS=y

# Additional required configurations for DECT stack
CONFIG_NET_STATISTICS=y
CONFIG_NET_STATISTICS_USER_API=y

# Disable antenna and modem info (not needed for testing)
CONFIG_MODEM_ANTENNA=n
# CONFIG_MODEM_INFO=y  # Temporarily disabled due to segfault

# Disable components that require hardware for testing
CONFIG_MBEDTLS=n
CONFIG_NORDIC_SECURITY_BACKEND=n
```

## src/main.c
```c
/*
 * Copyright (c) 2025 Nordic Semiconductor ASA
 *
 * SPDX-License-Identifier: LicenseRef-Nordic-5-Clause
 */

#include <unity.h>
#include <zephyr/kernel.h>
#include <stdlib.h>
#ifdef CONFIG_BOARD_NATIVE_SIM
#include "posix_board_if.h"
#endif

/* Include test functions from test_dect_integration.c */
extern void test_dect_stack_initialization(void);
extern void test_dect_settings_reset_to_defaults(void);
extern void test_dect_scan_request_band1(void);
extern void test_dect_pt_association_request(void);
extern void test_dect_pt_neigbor_list_info_req(void);
extern void test_dect_pt_status_info_req(void);
extern void test_dect_pt_association_release(void);
extern void test_dect_ft_activate(void);
extern void test_dect_ft_rssi_scan(void);
extern void test_dect_deactivate(void);
extern void test_dect_deactivated_requests_fail(void);
extern void test_dect_ft_configuration(void);
extern void test_dect_pt_complete_workflow(void);

/* Test result tracking structure */
typedef struct {
	const char *name;
	const char *function_name;
	bool passed;
} test_result_t;

/* Global test result tracking array */
static test_result_t test_results[] = {
	{"DECT stack initialization", "test_dect_stack_initialization", false},
	{"Settings reset to defaults", "test_dect_settings_reset_to_defaults", false},
	{"Network scan (Band 1)", "test_dect_scan_request_band1", false},
	{"PT association request", "test_dect_pt_association_request", false},
	{"PT neighbor list/info req", "test_dect_pt_neigbor_list_info_req", false},
	{"PT status info request", "test_dect_pt_status_info_req", false},
	{"PT association release", "test_dect_pt_association_release", false},
	{"DECT stack deactivation", "test_dect_deactivate", false},
	{"Deactivated requests fail", "test_dect_deactivated_requests_fail", false},
	{"FT configuration", "test_dect_ft_configuration", false},
	{"DECT stack activation", "test_dect_ft_activate", false},
	{"DECT RSSI scan", "test_dect_ft_rssi_scan", false}};

#define NUM_TESTS ARRAY_SIZE(test_results)

/**
 * Helper function to run a test and track its result
 */
#define RUN_TEST_AND_TRACK(test_func, test_index)                                                  \
	do {                                                                                       \
		int tests_before = Unity.TestFailures;                                             \
		RUN_TEST(test_func);                                                               \
		test_results[test_index].passed = (Unity.TestFailures == tests_before);            \
	} while (0)

/**
 * Main function - runs all Unity tests
 */
int main(void)
{
	/* Initialize Unity */
	UNITY_BEGIN();

	printk("=== DECT NR+ Simple Integration Tests ===\n");
	printk("Target: native_sim\n");
	printk("Framework: Unity\n");
	printk("Scope: Basic DECT operations with mocked libmodem\n\n");

	/* Run DECT integration tests with result tracking */
	RUN_TEST_AND_TRACK(test_dect_stack_initialization, 0);
	RUN_TEST_AND_TRACK(test_dect_settings_reset_to_defaults, 1);
	RUN_TEST_AND_TRACK(test_dect_scan_request_band1, 2);
	RUN_TEST_AND_TRACK(test_dect_pt_association_request, 3);
	RUN_TEST_AND_TRACK(test_dect_pt_neigbor_list_info_req, 4);
	RUN_TEST_AND_TRACK(test_dect_pt_status_info_req, 5);
	RUN_TEST_AND_TRACK(test_dect_pt_association_release, 6);
	RUN_TEST_AND_TRACK(test_dect_deactivate, 7);
	RUN_TEST_AND_TRACK(test_dect_deactivated_requests_fail, 8);
	RUN_TEST_AND_TRACK(test_dect_ft_configuration, 9);
	RUN_TEST_AND_TRACK(test_dect_ft_activate, 10);
	RUN_TEST_AND_TRACK(test_dect_ft_rssi_scan, 11);

	/* Capture Unity statistics before UNITY_END() */
	int total_tests = Unity.NumberOfTests;
	int failed_tests = Unity.TestFailures;
	int passed_tests = total_tests - failed_tests;
	int success_rate_int = total_tests > 0 ? (passed_tests * 100) / total_tests : 0;

	/* Complete and report test results */
	int result = UNITY_END();

	/* Print minimal test summary with detailed test case status */
	printk("\n");
	printk("=== DECT NR+ TEST SUMMARY ===\n");
	printk("Tests: %d | Passed: %d | Failed: %d | Rate: %d%%\n", total_tests, passed_tests,
	       failed_tests, success_rate_int);

	printk("\nTEST CASE RESULTS:\n");
	printk("------------------\n");

	/* Print results based on actual test outcomes */
	for (int i = 0; i < NUM_TESTS; i++) {
		if (test_results[i].passed) {
			printk("\033[32m[PASS]\033[0m %-35s\n", test_results[i].function_name);
		} else {
			printk("\033[31m[FAIL]\033[0m %-35s\n", test_results[i].function_name);
		}
	}

	if (result == 0) {
		printk("\n\033[32mALL TESTS PASSED!\033[0m\n");
		printk("\033[32mComplete DECT lifecycle: Init→Reset→Scan→Associate→"
		       "Release→Deactivate→FT config\033[0m\n");
	} else {
		printk("\n\033[31mSOME TESTS FAILED!\033[0m\n");
		printk("\033[33mCheck individual test results above for details\033[0m\n");
	}
	printk("==============================\n");

	/* Exit automatically for native_sim - prevents hanging after tests complete */
	printk("Tests completed with result: %d\n", result);

#ifdef CONFIG_BOARD_NATIVE_SIM
#ifdef CONFIG_COVERAGE
	/* When coverage is enabled, we need to explicitly exit to ensure coverage data is written*/
	/* This ensures gcov coverage data (.gcda files) are properly flushed on exit */
	/* Note: This exits immediately, so output may be truncated - coverage data is prioritized*/
	posix_exit(result);

	/* Should be unreachable: */
	return 1;
#else
	/* Without coverage, let the program exit normally so all output is visible */
	return result;
#endif
#else
	return result;
#endif
}
```

## src/test_dect_utils.c
```c
/**
 * @file test_dect_utils.c
 * @brief Common test utilities implementation for DECT integration tests
 */

#include "test_dect_utils.h"
#include "mock_nrf_modem_dect_mac.h"
#include <zephyr/net/net_mgmt.h>
#include <zephyr/kernel.h>
#include <zephyr/logging/log.h>
#include <string.h>
#include <errno.h>

LOG_MODULE_REGISTER(test_dect_utils, LOG_LEVEL_INF);

/* External event tracking variables from test_dect_integration.c */
extern bool dect_scan_result_received;
extern bool dect_scan_done_received;
extern enum dect_status_values dect_scan_done_status;
extern struct dect_scan_result_evt received_beacon_data;
extern bool beacon_data_valid;

extern bool dect_association_changed_received;
extern bool dect_association_created_received;
extern bool dect_association_failed_received;
extern struct dect_association_changed_evt received_association_data;
extern bool dect_network_status_received;
extern struct dect_network_status_evt received_network_status_data;
extern bool dect_activate_done_received;
extern enum dect_status_values dect_activate_done_status;
extern bool dect_deactivate_done_received;
extern enum dect_status_values dect_deactivate_done_status;
extern bool dect_rssi_scan_result_received;
extern struct dect_rssi_scan_result_evt received_rssi_scan_result_data;
extern bool dect_rssi_scan_done_received;
extern enum dect_status_values dect_rssi_scan_done_status;

/* External mock call counters */
extern int mock_nrf_modem_dect_control_configure_call_count;
extern int mock_nrf_modem_dect_control_functional_mode_set_call_count;
extern int mock_nrf_modem_dect_mac_cluster_configure_call_count;

int test_dect_network_scan(struct net_if *iface, const struct dect_scan_params *scan_params,
			   const struct test_dect_scan_beacon_params *beacon_params,
			   bool simulate_completion, struct test_dect_scan_result *result)
{
	int ret;

	if (!iface || !scan_params || !result) {
		return -EINVAL;
	}

	/* Initialize result structure */
	memset(result, 0, sizeof(*result));

	/* Reset scan event tracking flags */
	dect_scan_result_received = false;
	dect_scan_done_received = false;
	beacon_data_valid = false;

	/* State persists between tests - mock call counters are not reset */

	/* Call the real net_mgmt API for DECT scan - this should trigger
	 * nrf_modem_dect_mac_network_scan
	 */
	ret = net_mgmt(NET_REQUEST_DECT_SCAN, iface, (void *)scan_params, sizeof(*scan_params));

	if (ret != 0) {
		LOG_ERR("Network scan request failed: %d", ret);
		return ret;
	}

	/* Wait a short time for scan to start */
	k_sleep(K_MSEC(50));

	/* Optionally simulate cluster beacon reception */
	if (beacon_params && mock_ntf_callbacks.cluster_beacon_ntf) {
		struct nrf_modem_dect_mac_cluster_beacon_ntf_cb_params beacon_cb_params = {
			.channel = beacon_params->channel,
			.transmitter_short_rd_id = beacon_params->transmitter_short_rd_id,
			.transmitter_long_rd_id = beacon_params->transmitter_long_rd_id,
			.network_id = beacon_params->network_id,
			.rx_signal_info = {.mcs = beacon_params->mcs,
					   .transmit_power = beacon_params->transmit_power,
					   .rssi_2 = beacon_params->rssi_2,
					   .snr = beacon_params->snr}};

		LOG_DBG("Simulating cluster beacon callback: channel=%d, short_rd_id=0x%04X, "
			"long_rd_id=0x%08X",
			beacon_cb_params.channel, beacon_cb_params.transmitter_short_rd_id,
			beacon_cb_params.transmitter_long_rd_id);

		mock_ntf_callbacks.cluster_beacon_ntf(&beacon_cb_params);

		/* Wait for beacon processing */
		k_sleep(K_MSEC(100));
	} else if (beacon_params) {
		LOG_WRN("Beacon parameters provided but no cluster beacon callback registered");
	}

	/* Optionally simulate scan completion */
	if (simulate_completion && mock_op_callbacks.network_scan) {
		struct nrf_modem_dect_mac_network_scan_cb_params scan_complete_params = {
			.status = NRF_MODEM_DECT_MAC_STATUS_OK,
			.num_scanned_channels = scan_params->channel_count};

		LOG_DBG("Simulating scan completion: status=OK, channels=%d",
			scan_complete_params.num_scanned_channels);

		mock_op_callbacks.network_scan(&scan_complete_params);

		/* Allow time for scan completion processing */
		k_sleep(K_MSEC(100));
	}

	/* Populate result structure */
	result->scan_result_received = dect_scan_result_received;
	result->scan_done_received = dect_scan_done_received;
	result->scan_done_status = dect_scan_done_status;
	result->beacon_data_valid = beacon_data_valid;
	if (beacon_data_valid) {
		memcpy(&result->beacon_data, &received_beacon_data, sizeof(result->beacon_data));
	}

	LOG_DBG("Network scan completed: result_received=%s, done_received=%s, status=%d",
		result->scan_result_received ? "true" : "false",
		result->scan_done_received ? "true" : "false", result->scan_done_status);

	return 0;
}

int test_dect_association_request(
	struct net_if *iface, uint32_t target_long_rd_id,
	const struct test_dect_association_response_params *response_params,
	bool simulate_completion, bool simulate_network_joined,
	struct test_dect_association_result *result)
{
	int ret;
	struct dect_associate_req_params assoc_params = {
		.target_long_rd_id = target_long_rd_id
	};

	/* Default association response parameters */
	struct test_dect_association_response_params default_response = {
		.ack_status = true,
		.number_of_flows = 1,
		.number_of_rx_harq_processes = 4,
		.max_number_of_harq_re_rx = 3,
		.number_of_tx_harq_processes = 4,
		.max_number_of_harq_re_tx = 3};

	const struct test_dect_association_response_params *resp_params =
		response_params ? response_params : &default_response;

	if (!iface || !result) {
		return -EINVAL;
	}

	/* Initialize result structure */
	memset(result, 0, sizeof(*result));

	/* Reset association event tracking flags */
	dect_association_changed_received = false;
	dect_association_created_received = false;
	dect_association_failed_received = false;
	dect_network_status_received = false;

	/* State persists between tests - mock call counters are not reset */

	LOG_DBG("Associating with Long RD ID: 0x%08X", target_long_rd_id);

	/* Call the real net_mgmt API for DECT association - this should trigger
	 * nrf_modem_dect_mac_association
	 */
	ret = net_mgmt(NET_REQUEST_DECT_ASSOCIATION, iface, &assoc_params, sizeof(assoc_params));

	if (ret != 0) {
		LOG_ERR("Association request failed: %d", ret);
		return ret;
	}

	/* Wait a short time for association to start */
	k_sleep(K_MSEC(50));

	/* Optionally simulate association operation completion */
	if (simulate_completion && mock_op_callbacks.association) {
		struct nrf_modem_dect_mac_association_cb_params assoc_op_params = {
			.status = NRF_MODEM_DECT_MAC_STATUS_OK,
			.long_rd_id = target_long_rd_id,
			.rx_signal_info = {0},
			.ipv6_config = {0},
			.number_of_ies = 0,
			.ies = NULL};

		/* Initialize association response structure */
		assoc_op_params.association_response.bit_mask = 0;
		assoc_op_params.association_response.ack_status = resp_params->ack_status;
		assoc_op_params.association_response.number_of_flows = resp_params->number_of_flows;
		assoc_op_params.association_response.number_of_rx_harq_processes =
			resp_params->number_of_rx_harq_processes;
		assoc_op_params.association_response.max_number_of_harq_re_rx =
			resp_params->max_number_of_harq_re_rx;
		assoc_op_params.association_response.number_of_tx_harq_processes =
			resp_params->number_of_tx_harq_processes;
		assoc_op_params.association_response.max_number_of_harq_re_tx =
			resp_params->max_number_of_harq_re_tx;

		/* Set the flag to indicate we have association response data */
		assoc_op_params.flags.has_association_response = 1;

		LOG_DBG("Simulating association operation completion: status=OK, "
			"long_rd_id=0x%08X, ack_status=%s",
			assoc_op_params.long_rd_id,
			assoc_op_params.association_response.ack_status ? "true" : "false");

		mock_op_callbacks.association(&assoc_op_params);

		/* Wait for association operation processing */
		k_sleep(K_MSEC(50));
		k_sleep(K_MSEC(100));
	} else if (simulate_completion) {
		LOG_WRN("Association completion requested but no association callback registered");
	}

	/* Optionally simulate network joined status after successful association */
	if (simulate_network_joined && simulate_completion) {
		LOG_DBG("Simulating network joined status after successful association");

		struct dect_network_status_evt network_joined_event = {
			.network_status = DECT_NETWORK_STATUS_JOINED,
			.dect_err_cause = DECT_MAC_STATUS_OK,
			.os_err_cause = 0};

		/* Simulate sending the network status event through the real DECT stack */
		dect_mgmt_network_status_evt(iface, network_joined_event);

		/* Wait for network status event processing */
		k_sleep(K_MSEC(50));
	}

	/* Populate result structure */
	result->association_changed_received = dect_association_changed_received;
	result->association_created_received = dect_association_created_received;
	result->association_failed_received = dect_association_failed_received;
	if (dect_association_changed_received) {
		memcpy(&result->association_data, &received_association_data,
		       sizeof(result->association_data));
	}

	result->network_status_received = dect_network_status_received;
	if (dect_network_status_received) {
		memcpy(&result->network_status_data, &received_network_status_data,
		       sizeof(result->network_status_data));
	}

	LOG_DBG("Association completed: changed_received=%s, created_received=%s, "
		"failed_received=%s, network_status_received=%s",
		result->association_changed_received ? "true" : "false",
		result->association_created_received ? "true" : "false",
		result->association_failed_received ? "true" : "false",
		result->network_status_received ? "true" : "false");

	return 0;
}

int test_dect_status_info_get(struct net_if *iface, struct dect_status_info *status_info)
{
	int ret;

	if (!iface || !status_info) {
		return -EINVAL;
	}

	/* Initialize status info structure */
	memset(status_info, 0, sizeof(*status_info));

	LOG_DBG("Requesting DECT status info with NET_REQUEST_DECT_STATUS_INFO_GET");

	/* Make synchronous status info request */
	ret = net_mgmt(NET_REQUEST_DECT_STATUS_INFO_GET, iface, status_info, sizeof(*status_info));

	if (ret != 0) {
		LOG_ERR("Status info request failed: %d", ret);
		return ret;
	}

	LOG_DBG("Status info received:");
	LOG_DBG("- mdm_activated: %s", status_info->mdm_activated ? "true" : "false");
	LOG_DBG("- parent_count: %d", status_info->parent_count);
	LOG_DBG("- child_count: %d", status_info->child_count);
	LOG_DBG("- cluster_running: %s", status_info->cluster_running ? "true" : "false");
	LOG_DBG("- nw_beacon_running: %s", status_info->nw_beacon_running ? "true" : "false");
	if (status_info->parent_count > 0) {
		LOG_DBG("- parent_associations[0].long_rd_id: 0x%08X",
			status_info->parent_associations[0].long_rd_id);
	}

	return 0;
}

int test_dect_association_release(struct net_if *iface, uint32_t target_long_rd_id,
				  bool simulate_completion, bool simulate_network_unjoined,
				  struct test_dect_association_release_result *result)
{
	int ret;
	struct dect_associate_rel_params release_params = {.target_long_rd_id = target_long_rd_id};

	if (!iface || !result) {
		return -EINVAL;
	}

	/* Initialize result structure */
	memset(result, 0, sizeof(*result));

	/* Reset association event tracking flags */
	dect_association_changed_received = false;
	dect_network_status_received = false;

	/* State persists between tests - mock call counters are not reset */

	LOG_DBG("Releasing association with Long RD ID: 0x%08X", target_long_rd_id);

	/* Request association release */
	ret = net_mgmt(NET_REQUEST_DECT_ASSOCIATION_RELEASE, iface, &release_params,
		       sizeof(release_params));

	if (ret != 0) {
		LOG_ERR("Association release request failed: %d", ret);
		return ret;
	}

	/* Optionally simulate association release operation completion */
	if (simulate_completion && mock_op_callbacks.association_release) {
		struct nrf_modem_dect_mac_association_release_cb_params release_op_params = {
			.long_rd_id = target_long_rd_id};

		LOG_DBG("Simulating association release operation completion for long_rd_id=0x%08X",
			release_op_params.long_rd_id);

		mock_op_callbacks.association_release(&release_op_params);

		/* Wait for association release processing */
		k_sleep(K_MSEC(100));
	} else if (simulate_completion) {
		LOG_WRN("Association release completion requested but no callback registered");
	}

	/* Optionally simulate network unjoined status after association release */
	if (simulate_network_unjoined && simulate_completion) {
		LOG_DBG("Simulating network unjoined status after association release");

		/* Reset network status event flag */
		dect_network_status_received = false;

		struct dect_network_status_evt network_unjoined_event = {
			.network_status = DECT_NETWORK_STATUS_UNJOINED,
			.dect_err_cause = DECT_MAC_STATUS_OK,
			.os_err_cause = 0};

		/* Simulate sending the network status event through the real DECT stack */
		dect_mgmt_network_status_evt(iface, network_unjoined_event);

		/* Wait for network status event processing */
		k_sleep(K_MSEC(50));
	}

	/* Populate result structure */
	result->association_changed_received = dect_association_changed_received;
	if (dect_association_changed_received) {
		memcpy(&result->association_data, &received_association_data,
		       sizeof(result->association_data));
	}

	result->network_status_received = dect_network_status_received;
	if (dect_network_status_received) {
		memcpy(&result->network_status_data, &received_network_status_data,
		       sizeof(result->network_status_data));
	}

	LOG_DBG("Association release completed: changed_received=%s, network_status_received=%s",
		result->association_changed_received ? "true" : "false",
		result->network_status_received ? "true" : "false");

	return 0;
}

int test_dect_perform_activate(struct net_if *iface, uint32_t wait_timeout_ms,
			       struct test_dect_activate_result *result)
{
	int ret;
	uint32_t timeout = wait_timeout_ms > 0 ? wait_timeout_ms : 250;

	if (!iface || !result) {
		return -EINVAL;
	}

	/* Initialize result structure */
	memset(result, 0, sizeof(*result));

	/* Reset activation event flag */
	dect_activate_done_received = false;

	/* Record baseline call counts (state persists between tests) */
	int baseline_configure = mock_nrf_modem_dect_control_configure_call_count;
	int baseline_functional_mode_set =
		mock_nrf_modem_dect_control_functional_mode_set_call_count;

	LOG_DBG("Requesting DECT stack activation with NET_REQUEST_DECT_ACTIVATE");

	/* Request DECT stack activation - no parameters needed */
	ret = net_mgmt(NET_REQUEST_DECT_ACTIVATE, iface, NULL, 0);

	if (ret != 0) {
		LOG_ERR("DECT activation request failed: %d", ret);
		return ret;
	}

	/* Wait a short time for the driver to call nrf_modem_dect_control_configure */
	k_sleep(K_MSEC(20));

	/* Verify that nrf_modem_dect_control_configure was called */
	if (mock_nrf_modem_dect_control_configure_call_count != baseline_configure + 1) {
		LOG_WRN("nrf_modem_dect_control_configure call count mismatch: expected %d, got %d",
			baseline_configure + 1, mock_nrf_modem_dect_control_configure_call_count);
	}

	/* Wait for configure op callback to complete (this triggers functional_mode_set) */
	k_sleep(K_MSEC(20));

	/* Verify that nrf_modem_dect_control_functional_mode_set was called after configure */
	if (mock_nrf_modem_dect_control_functional_mode_set_call_count !=
	    baseline_functional_mode_set + 1) {
		LOG_WRN("nrf_modem_dect_control_functional_mode_set "
			"call count mismatch: expected %d, got %d",
			baseline_functional_mode_set + 1,
			mock_nrf_modem_dect_control_functional_mode_set_call_count);
	}

	/* The mock automatically simulates the control_functional_mode callback via
	 * simulate_async_callback, which triggers the async callback chain that eventually
	 * results in NET_EVENT_DECT_ACTIVATE_DONE. Wait for the full activation process.
	 */
	LOG_DBG("DECT activation request sent, waiting %d ms for completion "
		"(configure and functional_mode_set called, waiting for async callback)",
		timeout);

	/* Wait for activation processing with async callback */
	k_sleep(K_MSEC(timeout));

	/* Populate result structure */
	result->activate_done_received = dect_activate_done_received;
	result->activate_done_status = dect_activate_done_status;
	result->configure_called =
		(mock_nrf_modem_dect_control_configure_call_count == baseline_configure + 1);
	result->functional_mode_set_called =
		(mock_nrf_modem_dect_control_functional_mode_set_call_count ==
		 baseline_functional_mode_set + 1);

	LOG_DBG("DECT activation completed: done_received=%s, status=%d, configure_called=%s, "
		"functional_mode_set_called=%s",
		result->activate_done_received ? "true" : "false", result->activate_done_status,
		result->configure_called ? "true" : "false",
		result->functional_mode_set_called ? "true" : "false");

	return 0;
}

int test_dect_perform_deactivate(struct net_if *iface, uint32_t wait_timeout_ms,
				 struct test_dect_deactivate_result *result)
{
	int ret;
	uint32_t timeout = wait_timeout_ms > 0 ? wait_timeout_ms : 250;

	if (!iface || !result) {
		return -EINVAL;
	}

	/* Initialize result structure */
	memset(result, 0, sizeof(*result));

	/* Reset deactivation event flag */
	dect_deactivate_done_received = false;

	LOG_DBG("Requesting DECT stack deactivation with NET_REQUEST_DECT_DEACTIVATE");

	/* Request DECT stack deactivation - no parameters needed */
	ret = net_mgmt(NET_REQUEST_DECT_DEACTIVATE, iface, NULL, 0);

	if (ret != 0) {
		LOG_ERR("DECT deactivation request failed: %d", ret);
		return ret;
	}

	LOG_DBG("DECT deactivation request sent, waiting %d ms for completion", timeout);

	/* Wait for deactivation processing with async callback */
	k_sleep(K_MSEC(timeout));

	/* Populate result structure */
	result->deactivate_done_received = dect_deactivate_done_received;
	result->deactivate_done_status = dect_deactivate_done_status;

	LOG_DBG("DECT deactivation completed: done_received=%s, status=%d",
		result->deactivate_done_received ? "true" : "false",
		result->deactivate_done_status);

	return 0;
}

int test_dect_perform_rssi_scan(struct net_if *iface, struct dect_rssi_scan_params *params,
				uint32_t wait_timeout_ms, struct test_dect_rssi_scan_result *result)
{
	int ret;
	uint32_t timeout = wait_timeout_ms > 0 ? wait_timeout_ms : 500;

	if (!iface || !params || !result) {
		return -EINVAL;
	}

	/* Initialize result structure */
	memset(result, 0, sizeof(*result));

	/* Reset RSSI scan event flags */
	dect_rssi_scan_result_received = false;
	dect_rssi_scan_done_received = false;

	/* State persists between tests - mock call counters are not reset */

	LOG_DBG("Requesting DECT RSSI scan with NET_REQUEST_DECT_RSSI_SCAN");

	/* Request DECT RSSI scan */
	ret = net_mgmt(NET_REQUEST_DECT_RSSI_SCAN, iface, params, sizeof(*params));

	if (ret != 0) {
		LOG_WRN("DECT RSSI scan request returned error: %d "
			"(may be accepted but fail async)",
			ret);
		/* Continue anyway - the request may be accepted but fail asynchronously */
		/* Wait a bit to see if the driver still processes it */
		k_sleep(K_MSEC(20));
	}

	/* Wait a short time for the driver to call nrf_modem_dect_mac_rssi_scan */
	k_sleep(K_MSEC(10));

	/* The mock automatically simulates the rssi_scan_ntf notification callback via
	 * simulate_async_callback, which triggers NET_EVENT_DECT_RSSI_SCAN_RESULT.
	 * Then it simulates the rssi_scan op callback which triggers NET_EVENT_DECT_RSSI_SCAN_DONE.
	 * Wait for the full RSSI scan process.
	 */
	LOG_DBG("DECT RSSI scan request sent, waiting %d ms for completion "
		"(rssi_scan called, waiting for async callbacks)",
		timeout);

	/* Wait for RSSI scan processing with async callbacks */
	k_sleep(K_MSEC(timeout));

	/* Populate result structure */
	result->rssi_scan_result_received = dect_rssi_scan_result_received;
	result->rssi_scan_done_received = dect_rssi_scan_done_received;
	result->rssi_scan_done_status = dect_rssi_scan_done_status;
	if (dect_rssi_scan_result_received) {
		memcpy(&result->rssi_scan_result_data, &received_rssi_scan_result_data,
		       sizeof(result->rssi_scan_result_data));

		/* Verify the content of RSSI scan result data */
		struct dect_rssi_scan_result_data *rssi_data =
			&result->rssi_scan_result_data.rssi_scan_result;

		/* Verify channel matches the requested channel */
		if (params && params->channel_count > 0 && params->channel_list) {
			if (rssi_data->channel != params->channel_list[0]) {
				LOG_WRN("RSSI scan result channel mismatch: expected %d, got %d",
					params->channel_list[0], rssi_data->channel);
			}
		}

		LOG_DBG("DECT RSSI scan result data: channel=%d, busy_percentage=%d%%, "
			"all_subslots_free=%s, scan_suitable_percent=%d%%, "
			"free_subslot_cnt=%d, possible_subslot_cnt=%d, busy_subslot_cnt=%d, "
			"another_cluster_detected=%s",
			rssi_data->channel, rssi_data->busy_percentage,
			rssi_data->all_subslots_free ? "true" : "false",
			rssi_data->scan_suitable_percent, rssi_data->free_subslot_cnt,
			rssi_data->possible_subslot_cnt, rssi_data->busy_subslot_cnt,
			rssi_data->another_cluster_detected_in_channel ? "true" : "false");
	}

	LOG_DBG("DECT RSSI scan completed: result_received=%s, done_received=%s, status=%d",
		result->rssi_scan_result_received ? "true" : "false",
		result->rssi_scan_done_received ? "true" : "false", result->rssi_scan_done_status);

	return 0;
}

int test_dect_perform_cluster_configure(struct net_if *iface, uint32_t wait_timeout_ms,
					struct test_dect_cluster_configure_result *result)
{
	uint32_t timeout = wait_timeout_ms > 0 ? wait_timeout_ms : 200;

	ARG_UNUSED(iface);

	if (!result) {
		return -EINVAL;
	}

	/* Initialize result structure */
	memset(result, 0, sizeof(*result));

	/* Record baseline call count (state persists between tests) */
	int baseline_cluster_configure = mock_nrf_modem_dect_mac_cluster_configure_call_count;

	LOG_DBG("Waiting for cluster configure to be called and async callback to complete");

	/* Wait for cluster configure processing with async callback */
	/* The mock automatically simulates the cluster_configure op callback via
	 * simulate_async_callback, which triggers the async callback chain.
	 * Wait for the full cluster configure process.
	 */
	k_sleep(K_MSEC(timeout));

	/* Populate result structure */
	result->cluster_configure_called =
		(mock_nrf_modem_dect_mac_cluster_configure_call_count > baseline_cluster_configure);

	LOG_DBG("DECT cluster configure completed: called=%s (call_count=%d, baseline=%d)",
		result->cluster_configure_called ? "true" : "false",
		mock_nrf_modem_dect_mac_cluster_configure_call_count, baseline_cluster_configure);

	return 0;
}
```

## src/test_dect_utils.h
```c
/**
 * @file test_dect_utils.h
 * @brief Common test utilities for DECT integration tests
 *
 * Provides reusable test utilities for DECT network operations such as scanning.
 */

#ifndef TEST_DECT_UTILS_H_
#define TEST_DECT_UTILS_H_

#include <zephyr/net/net_if.h>
#include <dect_net_l2_mgmt.h>
#include <nrf_modem_dect_mac.h>

#ifdef __cplusplus
extern "C" {
#endif

/**
 * @brief Beacon simulation parameters for network scan utility
 */
struct test_dect_scan_beacon_params {
	uint16_t channel;		  /**< Channel number */
	uint16_t transmitter_short_rd_id; /**< Short RD ID */
	uint32_t transmitter_long_rd_id;  /**< Long RD ID */
	uint16_t network_id;		  /**< Network ID */
	int8_t mcs;			  /**< MCS index */
	int8_t transmit_power;		  /**< Transmit power [0,15] */
	int8_t rssi_2;			  /**< RSSI in dBm */
	int8_t snr;			  /**< SNR in dB */
};

/**
 * @brief Network scan result structure
 */
struct test_dect_scan_result {
	bool scan_result_received; /**< True if NET_EVENT_DECT_SCAN_RESULT was received */
	bool scan_done_received;   /**< True if NET_EVENT_DECT_SCAN_DONE was received */
	enum dect_status_values scan_done_status; /**< Scan completion status */
	bool beacon_data_valid;			  /**< True if beacon data is valid */
	struct dect_scan_result_evt beacon_data;  /**< Received beacon data */
};

/**
 * @brief Association response simulation parameters
 */
struct test_dect_association_response_params {
	bool ack_status;		     /**< Association accepted */
	uint8_t number_of_flows;	     /**< Number of flows to accept */
	uint8_t number_of_rx_harq_processes; /**< Number of RX HARQ processes */
	uint8_t max_number_of_harq_re_rx;    /**< Max HARQ retransmissions (RX) */
	uint8_t number_of_tx_harq_processes; /**< Number of TX HARQ processes */
	uint8_t max_number_of_harq_re_tx;    /**< Max HARQ retransmissions (TX) */
};

/**
 * @brief Association result structure
 */
struct test_dect_association_result {
	bool association_changed_received; /**< True if NET_EVENT_DECT_ASSOCIATION_CHANGED rcvd */
	bool association_created_received; /**< True if DECT_ASSOCIATION_CREATED event received */
	bool association_failed_received;  /**< True if association failed */
	struct dect_association_changed_evt association_data; /**< Received association evt data */
	bool network_status_received; /**< True if NET_EVENT_DECT_NETWORK_STATUS received */
	struct dect_network_status_evt network_status_data; /**< Received nw status event data */
};

/**
 * @brief Perform a DECT network scan with optional beacon simulation
 *
 * This utility function performs a network scan operation and optionally simulates
 * beacon reception. It handles the complete scan workflow:
 * 1. Initiates the scan via net_mgmt API
 * 2. Optionally simulates cluster beacon reception
 * 3. Optionally simulates scan completion
 * 4. Returns scan results
 *
 * @param iface Network interface to use for the scan
 * @param scan_params Scan parameters (band, channels, scan time, etc.)
 * @param beacon_params Optional beacon simulation parameters. If NULL, no beacon
 *                      is simulated.
 * @param simulate_completion If true, simulate scan completion callback.
 *                            If false, caller must handle completion separately.
 * @param result Pointer to result structure to populate. Must not be NULL.
 *
 * @return 0 on success (scan request accepted), negative error code on failure
 */
int test_dect_network_scan(struct net_if *iface, const struct dect_scan_params *scan_params,
			   const struct test_dect_scan_beacon_params *beacon_params,
			   bool simulate_completion, struct test_dect_scan_result *result);

/**
 * @brief Perform a DECT association request with optional completion simulation
 *
 * This utility function performs an association operation and optionally simulates
 * association completion and network joined status. It handles the complete
 * association workflow:
 * 1. Initiates the association via net_mgmt API
 * 2. Optionally simulates association operation completion callback
 * 3. Optionally simulates network joined status event
 * 4. Returns association results
 *
 * @param iface Network interface to use for the association
 * @param target_long_rd_id Long RD ID of the target device to associate with
 * @param response_params Optional association response parameters. If NULL, uses
 *                        default successful response parameters.
 * @param simulate_completion If true, simulate association completion callback.
 *                            If false, caller must handle completion separately.
 * @param simulate_network_joined If true, simulate network joined status event
 *                                 after successful association.
 * @param result Pointer to result structure to populate. Must not be NULL.
 *
 * @return 0 on success (association request accepted), negative error code on failure
 */
int test_dect_association_request(
	struct net_if *iface, uint32_t target_long_rd_id,
	const struct test_dect_association_response_params *response_params,
	bool simulate_completion, bool simulate_network_joined,
	struct test_dect_association_result *result);

/**
 * @brief Get DECT status information (synchronous)
 *
 * This utility function performs a synchronous status info request and returns
 * the current DECT stack status. This is a synchronous operation that does not
 * require callback simulation.
 *
 * @param iface Network interface to use for the status request
 * @param status_info Pointer to status info structure to populate. Must not be NULL.
 *
 * @return 0 on success, negative error code on failure
 */
int test_dect_status_info_get(struct net_if *iface, struct dect_status_info *status_info);

/**
 * @brief Association release result structure
 */
struct test_dect_association_release_result {
	bool association_changed_received; /**< True if NET_EVENT_DECT_ASSOCIATION_CHANGED rcvd */
	struct dect_association_changed_evt association_data; /**< Received ass event data */
	bool network_status_received; /**< True if NET_EVENT_DECT_NETWORK_STATUS received */
	struct dect_network_status_evt network_status_data; /**< Received nw status event data */
};

/**
 * @brief Perform a DECT association release request with optional completion simulation
 *
 * This utility function performs an association release operation and optionally simulates
 * association release completion and network unjoined status. It handles the complete
 * association release workflow:
 * 1. Initiates the association release via net_mgmt API
 * 2. Optionally simulates association release operation completion callback
 * 3. Optionally simulates network unjoined status event
 * 4. Returns association release results
 *
 * @param iface Network interface to use for the association release
 * @param target_long_rd_id Long RD ID of the target device to release association with
 * @param simulate_completion If true, simulate association release completion callback.
 *                            If false, caller must handle completion separately.
 * @param simulate_network_unjoined If true, simulate network unjoined status event
 *                                   after successful association release.
 * @param result Pointer to result structure to populate. Must not be NULL.
 *
 * @return 0 on success (association release request accepted), negative error code on failure
 */
int test_dect_association_release(struct net_if *iface, uint32_t target_long_rd_id,
				  bool simulate_completion, bool simulate_network_unjoined,
				  struct test_dect_association_release_result *result);

/**
 * @brief Deactivation result structure
 */
struct test_dect_deactivate_result {
	bool deactivate_done_received; /**< True if NET_EVENT_DECT_DEACTIVATE_DONE was received */
	enum dect_status_values deactivate_done_status; /**< Deactivation completion status */
};

/**
 * @brief Activation result structure
 */
struct test_dect_activate_result {
	bool activate_done_received; /**< True if NET_EVENT_DECT_ACTIVATE_DONE was received */
	enum dect_status_values activate_done_status; /**< Activation completion status */
	bool configure_called;		 /**< True if nrf_modem_dect_control_configure was called */
	bool functional_mode_set_called; /**< True if nrf_modem_dect_control_functional_mode_set
					  * was called
					  */
};

/**
 * @brief Perform a DECT stack activation request
 *
 * This utility function performs a DECT stack activation operation. It handles the
 * activation workflow:
 * 1. Initiates the activation via net_mgmt API
 * 2. Waits for async activation completion event
 * 3. Returns activation results
 *
 * @param iface Network interface to use for the activation
 * @param wait_timeout_ms Timeout in milliseconds to wait for activation completion.
 *                        If 0, uses default timeout (250ms).
 * @param result Pointer to result structure to populate. Must not be NULL.
 *
 * @return 0 on success (activation request accepted), negative error code on failure
 */
int test_dect_perform_activate(struct net_if *iface, uint32_t wait_timeout_ms,
			       struct test_dect_activate_result *result);

/**
 * @brief Perform a DECT stack deactivation request
 *
 * This utility function performs a DECT stack deactivation operation. It handles the
 * deactivation workflow:
 * 1. Initiates the deactivation via net_mgmt API
 * 2. Waits for async deactivation completion event
 * 3. Returns deactivation results
 *
 * @param iface Network interface to use for the deactivation
 * @param wait_timeout_ms Timeout in milliseconds to wait for deactivation completion.
 *                        If 0, uses default timeout (250ms).
 * @param result Pointer to result structure to populate. Must not be NULL.
 *
 * @return 0 on success (deactivation request accepted), negative error code on failure
 */
int test_dect_perform_deactivate(struct net_if *iface, uint32_t wait_timeout_ms,
				 struct test_dect_deactivate_result *result);

/**
 * @brief RSSI scan result structure
 */
struct test_dect_rssi_scan_result {
	bool rssi_scan_result_received; /**< True if NET_EVENT_DECT_RSSI_SCAN_RESULT was rcvd */
	bool rssi_scan_done_received;	/**< True if NET_EVENT_DECT_RSSI_SCAN_DONE was rcvd */
	enum dect_status_values rssi_scan_done_status;		/**< RSSI scan completion status */
	struct dect_rssi_scan_result_evt rssi_scan_result_data; /**< Received RSSI scan results */
};

/**
 * @brief Perform a DECT RSSI scan request
 *
 * This utility function performs a DECT RSSI scan operation. It handles the RSSI scan workflow:
 * 1. Initiates the RSSI scan via net_mgmt API
 * 2. Verifies that nrf_modem_dect_mac_rssi_scan() is called
 * 3. Waits for async RSSI scan result notification (rssi_scan_ntf callback)
 * 4. Verifies NET_EVENT_DECT_RSSI_SCAN_RESULT is received
 * 5. Waits for async RSSI scan completion (rssi_scan op callback)
 * 6. Verifies NET_EVENT_DECT_RSSI_SCAN_DONE is received with success status
 * 7. Returns RSSI scan results
 *
 * @param iface Network interface to use for the RSSI scan
 * @param params Pointer to RSSI scan parameters. Must not be NULL.
 * @param wait_timeout_ms Timeout in milliseconds to wait for RSSI scan completion.
 *                        If 0, uses default timeout (500ms).
 * @param result Pointer to result structure to populate. Must not be NULL.
 *
 * @return 0 on success (RSSI scan request accepted), negative error code on failure
 */
int test_dect_perform_rssi_scan(struct net_if *iface, struct dect_rssi_scan_params *params,
				uint32_t wait_timeout_ms,
				struct test_dect_rssi_scan_result *result);

/**
 * @brief Cluster configure result structure
 */
struct test_dect_cluster_configure_result {
	bool cluster_configure_called;
};

/**
 * @brief Perform a DECT cluster configure operation
 *
 * This utility function verifies that cluster configure was called and waits for
 * the async callback to complete. The mock automatically simulates the async callback.
 *
 * @param iface Network interface (unused, kept for consistency with other utilities)
 * @param wait_timeout_ms Timeout in milliseconds to wait for cluster configure completion.
 *                        If 0, uses default timeout (200ms).
 * @param result Pointer to result structure to populate. Must not be NULL.
 *
 * @return 0 on success, negative error code on failure
 */
int test_dect_perform_cluster_configure(struct net_if *iface, uint32_t wait_timeout_ms,
					struct test_dect_cluster_configure_result *result);

#ifdef __cplusplus
}
#endif

#endif /* TEST_DECT_UTILS_H_ */
```

## src/thread_safe_log.c
```c
/**
 * @file thread_safe_log.c
 * @brief Thread-safe logging implementation
 */

#include "thread_safe_log.h"

/* Mutex for thread-safe logging */
K_MUTEX_DEFINE(log_mutex);

void init_thread_safe_logging(void)
{
	/* Mutex is already initialized by K_MUTEX_DEFINE */
	LOG_INF("Thread-safe logging initialized");
}
```
