## CMakeLists.txt
```
# SPDX-License-Identifier: Apache-2.0
# Copyright (c) 2025 Nordic Semiconductor ASA
# DECT NR+ Stack Integration Tests with Unity and CMock

cmake_minimum_required(VERSION 3.20.0)

# Use our custom Kconfig for test-specific configuration
set(KCONFIG_ROOT ${CMAKE_CURRENT_SOURCE_DIR}/Kconfig)

find_package(Zephyr REQUIRED HINTS $ENV{ZEPHYR_BASE})
project(dect_nrp_integrated_test)

# Unity Test Framework is provided by CONFIG_UNITY=y in prj.conf and Nordic SDK
# CMock headers are included but implementations come from Nordic SDK

# Add test source files for Unity-based integration testing
# Test source files
target_sources(app PRIVATE
    src/main.c
    src/test_dect_integration.c
    src/mocks/mock_nrf_modem_dect_mac.c
)

# The DECT L2 subsystem is now included automatically via Zephyr modules
# when CONFIG_NET_L2_DECT_MGMT=y is enabled in prj.conf
# No need to manually add the source files

# Include all necessary directories for DECT stack
target_include_directories(app PRIVATE
    ${CMAKE_CURRENT_SOURCE_DIR}/src/mocks
    ${ZEPHYR_BASE}/../nrfxlib/nrf_modem/include
    ${ZEPHYR_BASE}/../nrfxlib/common/include
    ${ZEPHYR_BASE}/../nrf/drivers/dect_nrp/nrf91_mac
    ${ZEPHYR_BASE}/../nrf/subsys/net/l2_dect_nrp/include
    ${ZEPHYR_BASE}/../nrf/include/net
    ${ZEPHYR_BASE}/include/zephyr/net
    ${ZEPHYR_BASE}/subsys/net/ip
)

# Add nrfxlib include directories globally so DECT stack can find headers
target_include_directories(zephyr_interface INTERFACE
    ${ZEPHYR_BASE}/../nrfxlib/nrf_modem/include
    ${ZEPHYR_BASE}/../nrfxlib/common/include
)

# All CONFIG values are now properly defined in Kconfig
# No need for manual compile definitions

# Unity and CMock libraries are provided by Nordic SDK modules

# Add custom target for coverage report generation
if(CONFIG_COVERAGE)
    add_custom_target(coverage_report
        COMMAND ${CMAKE_CURRENT_SOURCE_DIR}/generate_coverage.sh
        WORKING_DIRECTORY ${CMAKE_CURRENT_SOURCE_DIR}
        COMMENT "Generating DECT NR+ stack coverage report"
        DEPENDS app
    )
endif()
```

## prj.conf
```kconfig
# DECT NR+ Stack Integration Test Configuration for native_sim
# Tests complete stack from net_mgmt API to mocked libmodem

# Unity Test Framework
CONFIG_UNITY=y

# Code Coverage Support (for native_sim) - focus on DECT stack
# Disabled by default - enable when running coverage measurement
# The generate_coverage.sh script automatically enables these temporarily
CONFIG_COVERAGE=y
CONFIG_COVERAGE_NATIVE_GCOV=y

# Basic configuration for Unity testing on native_sim
CONFIG_TEST=y
CONFIG_ZTEST=n

# System configuration for DECT stack testing
CONFIG_MAIN_STACK_SIZE=8192
CONFIG_SYSTEM_WORKQUEUE_STACK_SIZE=4096

# Networking configuration for DECT integration testing
# Note: CONFIG_NRF_MODEM_LIB is NOT enabled - all modem functions are mocked
CONFIG_NETWORKING=y
CONFIG_NET_NATIVE=y
CONFIG_NET_IPV4=n
CONFIG_NET_IPV6=y
CONFIG_NET_MGMT=y
CONFIG_NET_MGMT_EVENT=y
CONFIG_NET_MGMT_EVENT_INFO=y
CONFIG_NET_MGMT_EVENT_INFO_DEFAULT_DATA_SIZE=208

# DECT L2 layer
CONFIG_NET_L2_DECT=y

# Note: Modem library CONFIG values are mocked via compile definitions in CMakeLists.txt

# DECT NR+ specific configurations with full MAC driver stack
CONFIG_DECT_NRP_MAC=y
CONFIG_DECT_NRP_MAC_DRIVER_NRF=y
CONFIG_DECT_NRP_MAC_CLUSTER_MAX_CHILD_ASSOCIATION_COUNT=8
CONFIG_DECT_NRP_MAC_LOG_LEVEL_INF=y
CONFIG_DECT_NRP_MAC_DEVICE_NAME="dect_test"
CONFIG_DECT_NRP_MAC_NET_IF_NO_AUTO_START=y

# Modem shared memory configuration (defined in Kconfig)

# DECT L2 networking layer
CONFIG_NET_L2_DECT_MGMT=y
CONFIG_NET_L2_DECT_LOG_LEVEL_INF=y
CONFIG_NET_L2_DECT_MGMT_LOG_LEVEL_INF=y

CONFIG_NET_LOG=y

# Suppress informational messages from DECT Bearer layer (like "Ethernet interface found")
CONFIG_NET_L2_DECT_BR_LOG_LEVEL_INF=n
CONFIG_NET_L2_DECT_BR_LOG_LEVEL_WRN=y

# Network management event logging
CONFIG_NET_MGMT_EVENT_LOG_LEVEL_INF=y

# Disable Ethernet L2 layer (not needed for DECT MAC testing)
CONFIG_NET_L2_ETHERNET=n
CONFIG_NET_L2_ETHERNET=n
CONFIG_ETH_NATIVE_POSIX=n

# Note: DECT stack is included manually via CMakeLists.txt sources
# This allows testing the complete stack with mocked nrf_modem_dect_mac.h

CONFIG_NET_INTERFACE_NAME=y
CONFIG_NET_INTERFACE_NAME_LEN=15
CONFIG_NET_IF_MAX_IPV6_COUNT=2

# Network buffers
CONFIG_NET_BUF=y
CONFIG_NET_BUF_DATA_SIZE=128
CONFIG_NET_BUF_POOL_USAGE=y
CONFIG_NET_PKT_RX_COUNT=15
CONFIG_NET_BUF_RX_COUNT=30
CONFIG_NET_PKT_TX_COUNT=15
CONFIG_NET_BUF_TX_COUNT=30

# Network stack sizes
CONFIG_NET_TX_STACK_SIZE=2048
CONFIG_NET_RX_STACK_SIZE=2048
CONFIG_NET_MGMT_EVENT_STACK_SIZE=2048
CONFIG_NET_MGMT_EVENT_QUEUE_SIZE=10
CONFIG_NET_MGMT_EVENT_QUEUE_TIMEOUT=5000

# Network context support
CONFIG_NET_CONTEXT_SNDTIMEO=y
CONFIG_NET_CONTEXT_RCVTIMEO=y

# System configuration
CONFIG_MAIN_STACK_SIZE=8192
CONFIG_SYSTEM_WORKQUEUE_STACK_SIZE=3072
CONFIG_HEAP_MEM_POOL_SIZE=25600

# Logging and debugging - Use DEFERRED mode to avoid threading issues
CONFIG_ASSERT=y
CONFIG_LOG=y
CONFIG_PRINTK=y
CONFIG_LOG_PRINTK=y
CONFIG_LOG_MODE_DEFERRED=y
CONFIG_LOG_DEFAULT_LEVEL=3
CONFIG_DEBUG_INFO=y
CONFIG_ASSERT_VERBOSE=y
CONFIG_RESET_ON_FATAL_ERROR=n

# Enhanced logging for threading visibility - now enabled for DEFERRED mode
CONFIG_LOG_BUFFER_SIZE=4096
CONFIG_LOG_PROCESS_TRIGGER_THRESHOLD=10
CONFIG_LOG_PROCESS_THREAD_STACK_SIZE=2048
CONFIG_LOG_PROCESS_THREAD_STARTUP_DELAY_MS=0

# Thread debugging support
CONFIG_THREAD_NAME=y

# Kernel options
CONFIG_ENTROPY_GENERATOR=y

# Settings for state persistence
CONFIG_FLASH=y
CONFIG_FLASH_MAP=y
CONFIG_MPU_ALLOW_FLASH_WRITE=y
CONFIG_NVS=y
CONFIG_SETTINGS=y
CONFIG_SETTINGS_NVS=y

# Additional required configurations for DECT stack
CONFIG_NET_STATISTICS=y
CONFIG_NET_STATISTICS_USER_API=y

# Disable antenna and modem info (not needed for testing)
CONFIG_MODEM_ANTENNA=n
# CONFIG_MODEM_INFO=y  # Temporarily disabled due to segfault

# Disable components that require hardware for testing
CONFIG_MBEDTLS=n
CONFIG_NORDIC_SECURITY_BACKEND=n
```

## src/main.c
```c
/*
 * Copyright (c) 2025 Nordic Semiconductor ASA
 *
 * SPDX-License-Identifier: LicenseRef-Nordic-5-Clause
 */

#include <unity.h>
#include <zephyr/kernel.h>
#include <stdlib.h>

/* Include test functions from test_dect_integration.c */
extern void test_dect_stack_initialization(void);
extern void test_dect_settings_reset_to_defaults(void);
extern void test_dect_scan_request_band1(void);
extern void test_dect_pt_association_request(void);
extern void test_dect_pt_neigbor_list_info_req(void);
extern void test_dect_pt_status_info_req(void);
extern void test_dect_pt_association_release(void);
extern void test_dect_deactivate(void);
extern void test_dect_deactivated_requests_fail(void);
extern void test_dect_ft_configuration(void);
extern void test_dect_pt_complete_workflow(void);

/* Test result tracking structure */
typedef struct {
	const char *name;
	const char *function_name;
	bool passed;
} test_result_t;

/* Global test result tracking array */
static test_result_t test_results[] = {
	{"DECT stack initialization", "test_dect_stack_initialization", false},
	{"Settings reset to defaults", "test_dect_settings_reset_to_defaults", false},
	{"Network scan (Band 1)", "test_dect_scan_request_band1", false},
	{"PT association request", "test_dect_pt_association_request", false},
	{"PT neighbor list/info req", "test_dect_pt_neigbor_list_info_req", false},
	{"PT status info request", "test_dect_pt_status_info_req", false},
	{"PT association release", "test_dect_pt_association_release", false},
	{"DECT stack deactivation", "test_dect_deactivate", false},
	{"Deactivated requests fail", "test_dect_deactivated_requests_fail", false},
	{"FT configuration", "test_dect_ft_configuration", false}};

#define NUM_TESTS ARRAY_SIZE(test_results)

/**
 * Helper function to run a test and track its result
 */
#define RUN_TEST_AND_TRACK(test_func, test_index)                                                  \
	do {                                                                                       \
		int tests_before = Unity.TestFailures;                                             \
		RUN_TEST(test_func);                                                               \
		test_results[test_index].passed = (Unity.TestFailures == tests_before);            \
	} while (0)

/**
 * Main function - runs all Unity tests
 */
int main(void)
{
	/* Initialize Unity */
	UNITY_BEGIN();

	printk("=== DECT NR+ Simple Integration Tests ===\n");
	printk("Target: native_sim\n");
	printk("Framework: Unity\n");
	printk("Scope: Basic DECT operations with mocked libmodem\n\n");

	/* Run DECT integration tests with result tracking */
	RUN_TEST_AND_TRACK(test_dect_stack_initialization, 0);
	RUN_TEST_AND_TRACK(test_dect_settings_reset_to_defaults, 1);
	RUN_TEST_AND_TRACK(test_dect_scan_request_band1, 2);
	RUN_TEST_AND_TRACK(test_dect_pt_association_request, 3);
	RUN_TEST_AND_TRACK(test_dect_pt_neigbor_list_info_req, 4);
	RUN_TEST_AND_TRACK(test_dect_pt_status_info_req, 5);
	RUN_TEST_AND_TRACK(test_dect_pt_association_release, 6);
	RUN_TEST_AND_TRACK(test_dect_deactivate, 7);
	RUN_TEST_AND_TRACK(test_dect_deactivated_requests_fail, 8);
	RUN_TEST_AND_TRACK(test_dect_ft_configuration, 9);

	/* Capture Unity statistics before UNITY_END() */
	int total_tests = Unity.NumberOfTests;
	int failed_tests = Unity.TestFailures;
	int passed_tests = total_tests - failed_tests;
	int success_rate_int = total_tests > 0 ? (passed_tests * 100) / total_tests : 0;

	/* Complete and report test results */
	int result = UNITY_END();

	/* Print minimal test summary with detailed test case status */
	printk("\n");
	printk("=== DECT NR+ TEST SUMMARY ===\n");
	printk("Tests: %d | Passed: %d | Failed: %d | Rate: %d%%\n", total_tests, passed_tests,
	       failed_tests, success_rate_int);

	printk("\nTEST CASE RESULTS:\n");
	printk("------------------\n");

	/* Print results based on actual test outcomes */
	for (int i = 0; i < NUM_TESTS; i++) {
		if (test_results[i].passed) {
			printk("\033[32m[PASS]\033[0m %-35s\n", test_results[i].function_name);
		} else {
			printk("\033[31m[FAIL]\033[0m %-35s\n", test_results[i].function_name);
		}
	}

	if (result == 0) {
		printk("\n\033[32mALL TESTS PASSED!\033[0m\n");
		printk("\033[32mComplete DECT lifecycle: Init→Reset→Scan→Associate→"
		       "Release→Deactivate→FT config\033[0m\n");
	} else {
		printk("\n\033[31mSOME TESTS FAILED!\033[0m\n");
		printk("\033[33mCheck individual test results above for details\033[0m\n");
	}
	printk("==============================\n");

	/* Exit automatically for native_sim - prevents hanging after tests complete */
	printk("Tests completed with result: %d. Use Ctrl+C to exit or run with timeout.\n",
	       result);

	return result;
}
```

## src/thread_safe_log.h
```c
/**
 * @file thread_safe_log.h
 * @brief Thread-safe logging utilities for DECT integration tests
 */

#ifndef THREAD_SAFE_LOG_H
#define THREAD_SAFE_LOG_H

#include <zephyr/kernel.h>
#include <zephyr/logging/log.h>

LOG_MODULE_DECLARE(test_dect_integration);

/* Mutex for thread-safe logging */
extern struct k_mutex log_mutex;

/* Thread-safe logging macros using LOG macros */
#define SAFE_LOG_INF(fmt, ...)                                                                     \
	do {                                                                                       \
		k_mutex_lock(&log_mutex, K_FOREVER);                                               \
		LOG_INF(fmt, ##__VA_ARGS__);                                                       \
		k_msleep(1); /* Give log thread time to process */                                 \
		k_mutex_unlock(&log_mutex);                                                        \
	} while (0)

#define SAFE_LOG_ERR(fmt, ...)                                                                     \
	do {                                                                                       \
		k_mutex_lock(&log_mutex, K_FOREVER);                                               \
		LOG_ERR(fmt, ##__VA_ARGS__);                                                       \
		k_msleep(1); /* Give log thread time to process */                                 \
		k_mutex_unlock(&log_mutex);                                                        \
	} while (0)

#define SAFE_LOG_DBG(fmt, ...)                                                                     \
	do {                                                                                       \
		k_mutex_lock(&log_mutex, K_FOREVER);                                               \
		LOG_DBG(fmt, ##__VA_ARGS__);                                                       \
		k_msleep(1); /* Give log thread time to process */                                 \
		k_mutex_unlock(&log_mutex);                                                        \
	} while (0)

/* Initialize thread-safe logging */
void init_thread_safe_logging(void);

#endif /* THREAD_SAFE_LOG_H */
```
