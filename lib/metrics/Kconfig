## lib/metrics/Kconfig
```kconfig
#
# Copyright (c) 2022 Nordic Semiconductor ASA
#
# SPDX-License-Identifier: LicenseRef-Nordic-5-Clause
#

menuconfig METRICS
	bool "Metrics"
	depends on LOCATION
	depends on LTE_LINK_CONTROL
	depends on AT_MONITOR

if METRICS

config METRICS_CLOUD_THINGSPEAK
	bool "Cloud https://thingspeak.com/"
	default y
	depends on MODEM_INFO
	select REST_CLIENT
	select CJSON_LIB

if METRICS_CLOUD_THINGSPEAK
config METRICS_CLOUD_THINGSPEAK_HOSTNAME
	string "Hostname"
	default "api.thingspeak.com"

config METRICS_CLOUD_THINGSPEAK_CHANNEL_ID_STR
	string "Channel ID"

config METRICS_CLOUD_THINGSPEAK_WRITE_API_KEY
	string "API key for writing"
	help
	  API key used for authentication.

config METRICS_CLOUD_THINGSPEAK_TLS_SEC_TAG
	int "Security tag for TLS certificates"
	default 66
	help
	  Not supported but TODO if needed.

endif # METRICS_CLOUD_THINGSPEAK

module = METRICS
module-str = Metrics
source "${ZEPHYR_BASE}/subsys/logging/Kconfig.template.log_config"

endif # METRICS
```

## samples/nrf9160/lte_ble_gateway/boards/nrf9160dk_nrf9160_ns.conf
```kconfig
#CONFIG_NRF_SW_LPUART=y
#CONFIG_NRF_SW_LPUART_INT_DRIVEN=y
#CONFIG_UART_ASYNC_API=y
#CONFIG_UART_LINE_CTRL=y
#CONFIG_UART_2_ASYNC=y
#CONFIG_UART_2_INTERRUPT_DRIVEN=n
#CONFIG_UART_2_NRF_HW_ASYNC=y
#CONFIG_UART_2_NRF_HW_ASYNC_TIMER=2
#CONFIG_UART_2_NRF_ASYNC_LOW_POWER=y

CONFIG_LOG=y
CONFIG_ASSERT=y
CONFIG_DEBUG_INFO=y
CONFIG_LOG_STRDUP_MAX_STRING=94
#CONFIG_DEBUG_OPTIMIZATIONS=y
#CONFIG_NO_OPTIMIZATIONS=y
#CONFIG_FORCE_NO_ASSERT=y
CONFIG_ASSERT_VERBOSE=y
#CONFIG_ASSERT_LEVEL=2
#CONFIG_ASSERT_ON_ERRORS=y
#CONFIG_FAULT_DUMP=2
CONFIG_RESET_ON_FATAL_ERROR=n
CONFIG_EXTRA_EXCEPTION_INFO=y
#CONFIG_WATCHDOG=y

CONFIG_BT_DEBUG_LOG=y
#CONFIG_BT_DEBUG_HCI_DRIVER=y
```

## subsys/net/lib/nrf_cloud/Kconfig.nrf_cloud_ground_fix
```kconfig
# Copyright (c) 2022 Nordic Semiconductor
#
# SPDX-License-Identifier: LicenseRef-Nordic-5-Clause
#

config NRF_CLOUD_CELL_POS
	bool "Enable nRF Cloud Cellular Positioning over MQTT via Ground Fix"
	select NRF_CLOUD_GROUND_FIX

config NRF_CLOUD_GROUND_FIX
	bool "Enable nRF Cloud Ground Fix over MQTT"
	imply FPU
	depends on MODEM_INFO
	depends on MODEM_INFO_ADD_NETWORK
	depends on NRF_CLOUD_MQTT
	select CJSON_LIB
```
