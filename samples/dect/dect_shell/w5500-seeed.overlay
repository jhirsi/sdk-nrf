/*
 * Copyright (c) 2026 Nordic Semiconductor ASA
 *
 * SPDX-License-Identifier: LicenseRef-Nordic-5-Clause
 */

/*
 * Seeed W5500 Ethernet shield on nRF9151 DK (Zephyr shield seeed_w5500).
 *
 * Build:
 *   west build -b nrf9151dk/nrf9151/ns -- \
 *     -DSHIELD=seeed_w5500 \
 *     -DEXTRA_CONF_FILE="eth_common.conf;eth_w5500.conf" \
 *     -DDTC_OVERLAY_FILE=w5500-seeed.overlay
 *
 * For a fixed MAC, use w5500-seeed-static-mac.overlay instead.
 */

&eth_w5500 {
	zephyr,random-mac-address;
	/* spi-max-frequency = <24000000>; */
};
