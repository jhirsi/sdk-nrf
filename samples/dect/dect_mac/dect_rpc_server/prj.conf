## CMakeLists.txt
```
#
# Copyright (c) 2025 Nordic Semiconductor
#
# SPDX-License-Identifier: LicenseRef-Nordic-5-Clause
#

cmake_minimum_required(VERSION 3.20.0)

find_package(Zephyr REQUIRED HINTS $ENV{ZEPHYR_BASE})
project(dect_rpc_server)

target_sources(app PRIVATE
  src/main.c
)
```

## Kconfig
```
#
# Copyright (c) 2025 Nordic Semiconductor ASA
#
# SPDX-License-Identifier: LicenseRef-Nordic-5-Clause
#

mainmenu "DECT RPC Server Sample"

source "Kconfig.zephyr"
```

## sample.yaml
```
sample:
  name: DECT RPC Server
  description: |
    Sample demonstrating DECT NR+ RPC server running on nRF9151DK.
    The server exposes DECT NR+ net mgmt API over UART RPC.
    Requires an external nRF9151DK running the DECT RPC client sample.

common:
  board:
    - nrf9151dk_nrf9151

test:
  integration:
    - nrf_rpc
    - dect_nrp
```

## prj.conf
```kconfig
#
# Copyright (c) 2025 Nordic Semiconductor
#
# SPDX-License-Identifier: LicenseRef-Nordic-5-Clause
#

# Modem library
CONFIG_NRF_MODEM_LIB=y
CONFIG_NRF_MODEM_LINK_BINARY_DECT_MAC=y
CONFIG_NRF_MODEM_VARIANT_DECT_MAC=y
CONFIG_NRF_MODEM_LIB_ON_FAULT_APPLICATION_SPECIFIC=y
CONFIG_NRF_MODEM_LIB_SHMEM_RX_SIZE=6144
CONFIG_NRF_MODEM_LIB_SHMEM_TX_SIZE=12288
CONFIG_NRF_MODEM_LIB_CFUN_HOOKS=n
CONFIG_NRF_MODEM_LIB_TRACE=n

# Settings (required for DECT_NRP_MAC)
CONFIG_SETTINGS=y
CONFIG_SETTINGS_NVS=y
CONFIG_FLASH=y
CONFIG_FLASH_MAP=y
CONFIG_NVS=y

# DECT NR+
CONFIG_DECT_NRP_MAC=y
CONFIG_DECT_NRP_MAC_DRIVER_NRF=y
CONFIG_DECT_NRP_MAC_NET_IF_NO_AUTO_START=n
CONFIG_NET_L2_DECT=y
CONFIG_NET_L2_DECT_MGMT=y

# Disable auto antenna config
CONFIG_MODEM_ANTENNA=n
CONFIG_MODEM_ANTENNA_AT_COEX0=""

# For getting modem fw version and hw version
CONFIG_MODEM_INFO=y
CONFIG_MODEM_INFO_ADD_NETWORK=n
CONFIG_MODEM_INFO_ADD_SIM=n

# Zephyr networking
CONFIG_NETWORKING=y
CONFIG_NET_NATIVE=y
CONFIG_NET_STATISTICS=y

CONFIG_NET_IPV4=n
CONFIG_NET_IPV6=y
CONFIG_NET_IP_ADDR_CHECK=n

CONFIG_NET_MGMT=y
CONFIG_NET_MGMT_EVENT=y
CONFIG_NET_MGMT_EVENT_INFO=y
CONFIG_NET_MGMT_EVENT_INFO_DEFAULT_DATA_SIZE=208

CONFIG_NET_L2_DUMMY=n
CONFIG_NET_CONTEXT_SNDTIMEO=y
CONFIG_NET_CONTEXT_RCVTIMEO=y

CONFIG_NET_INTERFACE_NAME=y
CONFIG_NET_INTERFACE_NAME_LEN=15

CONFIG_NET_MGMT_EVENT_STACK_SIZE=2048
CONFIG_NET_MGMT_EVENT_QUEUE_SIZE=10
CONFIG_NET_MGMT_EVENT_QUEUE_TIMEOUT=5000

CONFIG_NET_IF_MAX_IPV6_COUNT=2

CONFIG_NET_SOCKETS=y
CONFIG_NET_SOCKETS_OFFLOAD=n

# nRF RPC
CONFIG_NRF_RPC=y
CONFIG_NRF_RPC_CBOR=y
CONFIG_NRF_RPC_ZCBOR_BACKUPS=1
CONFIG_NRF_RPC_THREAD_STACK_SIZE=6144
CONFIG_NRF_RPC_GROUP_INIT_WAIT_TIME=-1

# Transport selection: UART or MQTT
# Default: UART transport
# To use MQTT transport, use overlay: -- -DOVERLAY_CONFIG=overlay-mqtt.conf
# To use UART transport, use overlay: -- -DOVERLAY_CONFIG=overlay-uart.conf

# Default: UART transport
CONFIG_NRF_RPC_UART_TRANSPORT=y
CONFIG_NRF_RPC_UART_RELIABLE=y
CONFIG_UART_LINE_CTRL=y
CONFIG_UART_INTERRUPT_DRIVEN=y

# Disable MQTT transport by default
CONFIG_DECT_NRP_RPC_MQTT_TRANSPORT=n
CONFIG_NRF_CLOUD=n

# DECT RPC Server
CONFIG_DECT_NRP_RPC=y
CONFIG_DECT_NRP_RPC_SERVER=y
CONFIG_DECT_NRP_RPC_LOG_LEVEL_DBG=y

# Logging
CONFIG_LOG=y
CONFIG_LOG_MODE_DEFERRED=y
CONFIG_LOG_BUFFER_SIZE=8192
CONFIG_LOG_FUNC_NAME_PREFIX_DBG=n

# Explicitly disable SHELL to avoid circular dependency with NRF_RPC_UTILS_REMOTE_SHELL
CONFIG_SHELL=n

# Asserts
CONFIG_ASSERT=y
CONFIG_ASSERT_LEVEL=2
CONFIG_ASSERT_ON_ERRORS=y

# RPC Utils (required if client uses RPC Utils)
CONFIG_NRF_RPC_UTILS=y
CONFIG_NRF_RPC_UTILS_SERVER=y
CONFIG_NRF_RPC_UTILS_DEV_INFO=y
CONFIG_NRF_RPC_UTILS_SYSTEM_HEALTH=y
# Note: CONFIG_NRF_RPC_UTILS_REMOTE_SHELL requires CONFIG_SHELL, which is disabled
```

## overlay-debug.conf
```kconfig
#
# Copyright (c) 2025 Nordic Semiconductor
#
# SPDX-License-Identifier: LicenseRef-Nordic-5-Clause
#

# Enable debug logging for DECT NR+ stack components
CONFIG_DECT_NRP_MAC_LOG_LEVEL_DBG=y
CONFIG_NET_L2_DECT_LOG_LEVEL_DBG=y
CONFIG_NET_L2_DECT_MGMT_LOG_LEVEL_DBG=y
CONFIG_NET_L2_DECT_BR_LOG_LEVEL_DBG=y
CONFIG_NET_L2_DECT_CONN_MGR_LOG_LEVEL_DBG=y

# Enable debug logging for nRF RPC transport
CONFIG_NRF_RPC_TR_LOG_LEVEL_DBG=y
CONFIG_NRF_RPC_LOG_LEVEL_DBG=y

# Enable debug logging for UART (if using UART transport)
CONFIG_UART_LOG_LEVEL_DBG=y

# Increase log buffer for more verbose output
CONFIG_LOG_BUFFER_SIZE=16384
```

## overlay-mqtt.conf
```kconfig
#
# Copyright (c) 2025 Nordic Semiconductor ASA
#
# SPDX-License-Identifier: LicenseRef-Nordic-5-Clause
#

# MQTT transport configuration overlay
# Use this overlay to enable MQTT transport for DECT RPC:
# west build -b nrf9151dk/nrf9151/ns -- -DOVERLAY_CONFIG=overlay-mqtt.conf
#
# IMPORTANT: The order matters - disable base transports FIRST to prevent
# the NRF_RPC_TRANSPORT choice from defaulting to IPC_SERVICE

# Disable base nRF RPC transports (required for MQTT transport)
CONFIG_NRF_RPC_IPC_SERVICE=n
CONFIG_NRF_RPC_UART_TRANSPORT=n

# nRF Cloud MQTT
CONFIG_NRF_CLOUD=y
CONFIG_NRF_CLOUD_MQTT=y

# DECT RPC with MQTT transport
CONFIG_DECT_NRP_RPC_MQTT_TRANSPORT=y
```

## overlay-uart.conf
```kconfig
#
# Copyright (c) 2025 Nordic Semiconductor ASA
#
# SPDX-License-Identifier: LicenseRef-Nordic-5-Clause
#

# UART transport configuration overlay
# Use this overlay to enable UART transport for DECT RPC:
# west build -b nrf9151dk/nrf9151/ns -- -DOVERLAY_CONFIG=overlay-uart.conf

# UART transport for nRF RPC
CONFIG_NRF_RPC_UART_TRANSPORT=y
CONFIG_NRF_RPC_UART_RELIABLE=y
CONFIG_UART_LINE_CTRL=y
CONFIG_UART_INTERRUPT_DRIVEN=y

# Disable MQTT transport
CONFIG_DECT_NRP_RPC_MQTT_TRANSPORT=n
CONFIG_NRF_CLOUD=n
```

## boards/nrf9151dk_nrf9151_ns.overlay
```dts
/*
 * Copyright (c) 2025 Nordic Semiconductor
 *
 * SPDX-License-Identifier: LicenseRef-Nordic-5-Clause
 */

/ {
	chosen {
		nordic,rpc-uart = &uart1;
	};
};

&uart1 {
	status = "okay";
	hw-flow-control;
	current-speed = <1000000>;
};
```

## src/main.c
```c
/*
 * Copyright (c) 2025 Nordic Semiconductor ASA
 *
 * SPDX-License-Identifier: LicenseRef-Nordic-5-Clause
 */

#include <zephyr/logging/log.h>
#include <zephyr/kernel.h>
#include <nrf_rpc.h>
#include <modem/nrf_modem_lib.h>
#include <nrf_modem.h>

#include <net/l2_dect_nrp/rpc/server/dect_rpc_server.h>
#include <net/l2_dect_nrp/rpc/common/dect_rpc_group.h>

#if defined(CONFIG_DECT_NRP_RPC_MQTT_TRANSPORT)
#include <net/nrf_cloud.h>
#include <net/l2_dect_nrp/rpc/common/dect_rpc_mqtt_transport.h>
#endif

LOG_MODULE_REGISTER(dect_rpc_server_sample, LOG_LEVEL_DBG);

static void err_handler(const struct nrf_rpc_err_report *report)
{
	LOG_ERR("nRF RPC error %d occurred. See nRF RPC logs for more details", report->code);
}

void nrf_modem_fault_handler(struct nrf_modem_fault_info *fault_info)
{
	LOG_ERR("Modem crash reason: 0x%x, PC: 0x%x", fault_info->reason,
		fault_info->program_counter);
	__ASSERT(false, "Modem crash detected, halting application execution");
}

#if defined(CONFIG_DECT_NRP_RPC_MQTT_TRANSPORT)
static void nrf_cloud_event_handler(const struct nrf_cloud_evt *evt)
{
	switch (evt->type) {
	case NRF_CLOUD_EVT_TRANSPORT_CONNECTED:
		LOG_INF("nRF Cloud MQTT connected");
		break;
	case NRF_CLOUD_EVT_READY:
		LOG_INF("nRF Cloud ready");
		break;
	case NRF_CLOUD_EVT_RX_DATA_GENERAL:
		/* Check if this is a DECT RPC packet */
		if (dect_rpc_mqtt_transport_handle_rx_data(&evt->data)) {
			LOG_DBG("DECT RPC packet received and handled");
		}
		/* If not handled, it's other cloud data */
		break;
	case NRF_CLOUD_EVT_TRANSPORT_DISCONNECTED:
		LOG_INF("nRF Cloud disconnected");
		break;
	case NRF_CLOUD_EVT_TRANSPORT_CONNECT_ERROR:
		LOG_ERR("nRF Cloud connection error: %d", evt->status);
		break;
	case NRF_CLOUD_EVT_ERROR:
		LOG_ERR("nRF Cloud error: %d", evt->status);
		break;
	default:
		break;
	}
}
#endif

int main(void)
{
	int ret;

	LOG_INF("DECT RPC Server Sample");

	/* Initialize nRF Modem library (required for DECT MAC) */
	ret = nrf_modem_lib_init();
	if (ret != 0) {
		LOG_ERR("nRF Modem library init failed: %d", ret);
		return ret;
	}
	LOG_INF("nRF Modem library initialized");

#if defined(CONFIG_DECT_NRP_RPC_MQTT_TRANSPORT)
	LOG_INF("Initializing nRF Cloud MQTT");

	struct nrf_cloud_init_param init_param = {
		.event_handler = nrf_cloud_event_handler,
	};

	ret = nrf_cloud_init(&init_param);
	if (ret != 0) {
		LOG_ERR("nRF Cloud init failed: %d", ret);
		return ret;
	}

	LOG_INF("Connecting to nRF Cloud...");
	ret = nrf_cloud_connect();
	if (ret != 0 && ret != NRF_CLOUD_CONNECT_RES_ERR_ALREADY_CONNECTED) {
		LOG_ERR("nRF Cloud connect failed: %d", ret);
		return ret;
	}

	/* Wait a bit for connection to establish */
	k_sleep(K_SECONDS(2));
#endif

	LOG_INF("Initializing RPC server");

	ret = nrf_rpc_init(err_handler);
	if (ret != 0) {
		LOG_ERR("RPC init failed: %d", ret);
		return ret;
	}

	LOG_INF("Initializing DECT RPC server");

	ret = dect_rpc_server_init();
	if (ret != 0) {
		LOG_ERR("DECT RPC server init failed: %d", ret);
		return ret;
	}

	LOG_INF("DECT RPC server ready");
#if defined(CONFIG_DECT_NRP_RPC_MQTT_TRANSPORT)
	LOG_INF("Waiting for RPC commands from cloud via MQTT...");
#else
	LOG_INF("Waiting for RPC commands from client...");
#endif

	return 0;
}
```
