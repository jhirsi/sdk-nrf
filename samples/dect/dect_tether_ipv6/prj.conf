## Kconfig
```
#
# Copyright (c) 2026 Nordic Semiconductor ASA
#
# SPDX-License-Identifier: LicenseRef-Nordic-5-Clause
#

source "Kconfig.zephyr"

config DECT_TETHER_IPV6_SAMPLE_MDNS_DNS_SD
	bool "Advertise _dect-nr._udp on dect0 (mDNS DNS-SD, like dect_shell)"
	default n
	depends on MDNS_RESPONDER_DNS_SD
	help
	  Binds a UDP socket on the DECT interface and registers mDNS DNS-SD for
	  _dect-nr._udp.local so peers on DECT can browse this device (e.g. avahi-browse).
	  Enable CONFIG_NET_HOSTNAME and stack options via mdns.conf.

if DECT_TETHER_IPV6_SAMPLE_MDNS_DNS_SD

config DECT_TETHER_IPV6_SAMPLE_MDNS_DNS_SD_PORT
	int "UDP port for mDNS DNS-SD stub socket on dect0"
	default 4700
	range 1 65535
	help
	  Port bound on dect0 so dns_sd port_in_use checks succeed. Must match dns_sd_rec.port.

endif # DECT_TETHER_IPV6_SAMPLE_MDNS_DNS_SD


module = DECT_TETHER_IPV6_SAMPLE
module-str = DECT IPv6 tethering sample
source "${ZEPHYR_BASE}/subsys/logging/Kconfig.template.log_config"
```

## sample.yaml
```
# Copyright (c) 2026 Nordic Semiconductor ASA
# SPDX-License-Identifier: LicenseRef-Nordic-5-Clause

sample:
  name: DECT IPv6 tethering
  description: DECT IPv6 tethering (minimal RA + DHCPv6 + optional mDNS forward) trial
common:
  tags:
    - ci_build
    - sysbuild
    - ci_samples_dect
  sysbuild: true
  build_only: true
  integration_platforms:
    - nrf9151dk/nrf9151/ns
  platform_allow:
    - nrf9151dk/nrf9151/ns
tests:
  sample.dect.dect_tether_ipv6.pt_arceli_w5500:
    extra_args: SHIELD=arceli_eth_w5500 EXTRA_CONF_FILE=pt.conf;eth_common.conf;eth_w5500.conf DTC_OVERLAY_FILE=w5500-static-mac.overlay
  sample.dect.dect_tether_ipv6.pt_arceli_w5500_random_mac:
    extra_args: SHIELD=arceli_eth_w5500 EXTRA_CONF_FILE=pt.conf;eth_common.conf;eth_w5500.conf DTC_OVERLAY_FILE=w5500.overlay
  sample.dect.dect_tether_ipv6.pt_arceli_w5500_mdns:
    extra_args: SHIELD=arceli_eth_w5500 EXTRA_CONF_FILE=pt.conf;eth_common.conf;eth_w5500.conf;mdns-common.conf;mdns.conf;eth_mdns.conf;mdns_forward.conf DTC_OVERLAY_FILE=w5500-static-mac.overlay
  sample.dect.dect_tether_ipv6.pt_arceli_w5500_dect_rx_pool:
    extra_args: SHIELD=arceli_eth_w5500 EXTRA_CONF_FILE="pt.conf;eth_common.conf;eth_w5500.conf;dect_rx_pool.conf;dlc_resilient.conf" DTC_OVERLAY_FILE=w5500-static-mac.overlay
  sample.dect.dect_tether_ipv6.pt_arceli_w5500_10bt_hd_dect_rx_pool:
    extra_args: SHIELD=arceli_eth_w5500 EXTRA_CONF_FILE="pt.conf;eth_common.conf;eth_w5500.conf;eth_w5500_10bt_hd.conf;dect_rx_pool.conf;dlc_resilient.conf" DTC_OVERLAY_FILE=w5500-static-mac.overlay
  sample.dect.dect_tether_ipv6.pt_seeed_w5500:
    extra_args: SHIELD=seeed_w5500 EXTRA_CONF_FILE="pt.conf;eth_common.conf;eth_w5500.conf;eth_w5500_seeed.conf" DTC_OVERLAY_FILE=w5500-seeed-static-mac.overlay
  sample.dect.dect_tether_ipv6.pt_seeed_w5500_dect_rx_pool:
    extra_args: SHIELD=seeed_w5500 EXTRA_CONF_FILE="pt.conf;eth_common.conf;eth_w5500.conf;eth_w5500_seeed.conf;dect_rx_pool.conf;dlc_resilient.conf" DTC_OVERLAY_FILE=w5500-seeed-static-mac.overlay
  sample.dect.dect_tether_ipv6.pt_seeed_w5500_10bt_hd_dect_rx_pool:
    extra_args: SHIELD=seeed_w5500 EXTRA_CONF_FILE="pt.conf;eth_common.conf;eth_w5500.conf;eth_w5500_seeed.conf;eth_w5500_10bt_hd.conf;dect_rx_pool.conf;dlc_resilient.conf" DTC_OVERLAY_FILE=w5500-seeed-static-mac.overlay
```

## prj.conf
```kconfig
#
# Copyright (c) 2026 Nordic Semiconductor ASA
#
# SPDX-License-Identifier: LicenseRef-Nordic-5-Clause
#

CONFIG_TFM_PROFILE_TYPE_MINIMAL=y

CONFIG_DECT=y
CONFIG_DECT_DEFAULT_DEV_TYPE_PT=y
CONFIG_DECT_CLUSTER_MAX_CHILD_ASSOCIATION_COUNT=2

CONFIG_NRF_MODEM_LIB=y
CONFIG_NRF_MODEM_LINK_BINARY_DECT=y
CONFIG_NRF_MODEM_LIB_ON_FAULT_APPLICATION_SPECIFIC=y

CONFIG_DECT_MDM=y
CONFIG_DECT_MDM_DRIVER_NRF=y
CONFIG_DECT_MDM_NRF_CTRL_THREAD_STACK_SIZE=3584

CONFIG_NETWORKING=y
CONFIG_NET_NATIVE=y
CONFIG_NET_IPV4=n
CONFIG_NET_IPV6=y
CONFIG_NET_UDP=y
CONFIG_NET_MGMT=y
CONFIG_NET_MGMT_EVENT=y
CONFIG_NET_MGMT_EVENT_INFO=y
CONFIG_NET_MGMT_EVENT_INFO_DEFAULT_DATA_SIZE=208

CONFIG_NET_L2_DECT=y
CONFIG_NET_L2_DECT_MGMT=y
CONFIG_NET_L2_DECT_BR=n
CONFIG_NET_CONNECTION_MANAGER=y
CONFIG_NET_CONNECTION_MANAGER_MONITOR_STACK_SIZE=2560
CONFIG_NET_L2_DECT_CONN_MGR_AUTO_CONNECT=y
CONFIG_NET_L2_DECT_CONN_MGR_CONNECTION_PERSISTENCE=y

CONFIG_NET_L2_DECT_ULA=y
CONFIG_NET_L2_DECT_ULA_PREFIX="fdde:ad00:0000::"

CONFIG_NET_ROUTING=y

CONFIG_DECT_TETHER_IPV6_LIB=y
CONFIG_DECT_TETHER_IPV6_LOG_LEVEL_INF=y

CONFIG_MODEM_ANTENNA=n
CONFIG_MODEM_INFO=y
CONFIG_MODEM_INFO_ADD_NETWORK=n
CONFIG_MODEM_INFO_ADD_SIM=n

CONFIG_NET_SOCKETS=y
CONFIG_NET_SOCKETS_OFFLOAD=n
CONFIG_POSIX_API=y
CONFIG_NET_IF_MAX_IPV6_COUNT=6
CONFIG_NET_IF_UNICAST_IPV6_ADDR_COUNT=6
CONFIG_NET_IF_MCAST_IPV6_ADDR_COUNT=10
CONFIG_NET_IF_IPV6_PREFIX_COUNT=4
CONFIG_NET_INTERFACE_NAME=y
CONFIG_NET_MAX_CONTEXTS=12
CONFIG_NET_MAX_CONN=12

CONFIG_NET_RX_STACK_SIZE=4096
CONFIG_NET_TX_STACK_SIZE=4096
CONFIG_SYSTEM_WORKQUEUE_STACK_SIZE=8192

CONFIG_NET_BUF=y
CONFIG_NET_BUF_DATA_SIZE=128
CONFIG_NRF_MODEM_LIB_SHMEM_RX_SIZE=18432
CONFIG_NRF_MODEM_LIB_SHMEM_TX_SIZE=18432

CONFIG_NET_PKT_RX_COUNT=32
CONFIG_NET_PKT_TX_COUNT=64
CONFIG_NET_BUF_RX_COUNT=32
CONFIG_NET_BUF_TX_COUNT=64
CONFIG_NET_BUF_POOL_USAGE=y

CONFIG_NET_IPV6_NBR_CACHE=y
CONFIG_NET_IPV6_MAX_NEIGHBORS=10
CONFIG_NET_IPV6_ND=y

CONFIG_NET_MGMT_EVENT_STACK_SIZE=4608
CONFIG_NET_MGMT_EVENT_QUEUE_SIZE=30
CONFIG_NET_MGMT_EVENT_QUEUE_TIMEOUT=5000

CONFIG_NET_STATISTICS=y

CONFIG_SHELL=y
CONFIG_GETOPT_LONG=y
CONFIG_SHELL_PROMPT_UART="dect_tether_v6:~$ "
CONFIG_SHELL_BACKEND_SERIAL=y
CONFIG_SHELL_STACK_SIZE=9216
CONFIG_SHELL_CMD_BUFF_SIZE=4096
CONFIG_SHELL_ARGC_MAX=40
CONFIG_SHELL_BACKEND_SERIAL_RX_RING_BUFFER_SIZE=512
CONFIG_SHELL_BACKEND_SERIAL_API_INTERRUPT_DRIVEN=y
CONFIG_NET_SHELL=y
CONFIG_DECT_L2_SHELL_LIB=y
CONFIG_SHELL_LOG_BACKEND=y
CONFIG_LOG_BACKEND_UART=n

CONFIG_NET_DRIVERS=y
CONFIG_SERIAL=y

CONFIG_FLASH=y
CONFIG_FLASH_MAP=y
CONFIG_MPU_ALLOW_FLASH_WRITE=y
CONFIG_NVS=y
CONFIG_SETTINGS=y
CONFIG_SETTINGS_NVS=y

CONFIG_MAIN_STACK_SIZE=4096
CONFIG_ISR_STACK_SIZE=2048
CONFIG_HEAP_MEM_POOL_SIZE=25600
CONFIG_LOG=y
CONFIG_ASSERT=y

CONFIG_DK_LIBRARY=y
```

## dect_rx_pool.conf
```kconfig
# Copyright (c) 2026 Nordic Semiconductor ASA
# SPDX-License-Identifier: LicenseRef-Nordic-5-Clause
#
# DECT-private RX net_pkt/net_buf pool for dect_tether_ipv6.
#
# Append last in EXTRA_CONF_FILE, e.g.
#   eth_common.conf;eth_w5500.conf;dect_rx_pool.conf
#
# Why: this sample acts as the PT — DECT TX is the hot path (PC eth0 RX ->
# DECT TX uplink to FT), so the modem SHMEM split in eth_common.conf is
# TX-heavy. However, sustained PC->server uplink generates back-to-back
# TCP ACK bursts that arrive as small (60-96 B) DECT RX frames; those
# bursts saturate the private slab faster than the DLC RX thread can
# drain it. Sizing here is for burst depth (PKT_COUNT), not byte volume —
# fragment count can stay close to 1:1 since ACK-sized frames fit in one
# 256 B fragment.
#
# Tune _PKT_COUNT / _BUF_COUNT / _BUF_SIZE if "dect_mdm rx_pool" shows
# MaxUsed == Total under sustained PC->server traffic.
#
# Runtime inspection:
#   uart:~$ dect_mdm rx_pool

CONFIG_DECT_MDM_RX_PRIVATE_POOL=y

CONFIG_DECT_MDM_RX_PRIVATE_PKT_COUNT=35
CONFIG_DECT_MDM_RX_PRIVATE_BUF_COUNT=50
CONFIG_DECT_MDM_RX_PRIVATE_BUF_SIZE=128

# RX pipeline queues (event slab + msgq) must exceed PRIVATE_PKT_COUNT to
# avoid head-of-line blocking when the slab is fully in flight.
CONFIG_DECT_MDM_NRF_RX_EVENT_POOL_COUNT=40
CONFIG_DECT_MDM_NRF_RX_MSGQ_SIZE=40

# Visibility for the "dect_mdm rx_pool" shell:
CONFIG_NET_BUF_POOL_USAGE=y
CONFIG_MEM_SLAB_TRACE_MAX_UTILIZATION=y
```

## dhcpv6-debug.conf
```kconfig
# Copyright (c) 2026 Nordic Semiconductor ASA
#
# SPDX-License-Identifier: LicenseRef-Nordic-5-Clause
#
# DHCPv6 tether debugging: log each datagram received on UDP 547 and extra DBG
# lines from dect_tether_ipv6 (e.g. DHCP drops). Merge after prj.conf chain:
#
#   EXTRA_CONF_FILE="pt.conf;eth_common.conf;eth_w5500.conf;dhcpv6-debug.conf"
#
# Disable for production (Renew traffic can spam UART).

CONFIG_DECT_TETHER_IPV6_DHCPV6_RX_LOG=y
CONFIG_DECT_TETHER_IPV6_DHCPV6_TRACE=y
CONFIG_DECT_TETHER_IPV6_LOG_LEVEL_DBG=y
```

## dlc_resilient.conf
```kconfig
# Copyright (c) 2026 Nordic Semiconductor ASA
# SPDX-License-Identifier: LicenseRef-Nordic-5-Clause
#
# Loss-resilient DLC profile for dect_tether_ipv6 (PT side).
#
# Append last in EXTRA_CONF_FILE, e.g.
#   pt.conf;eth_common.conf;eth_w5500.conf;dlc_resilient.conf
#
# Why: the modem's stock DLC defaults are not a great match for a
# tether deployment. The two knobs below trade them for a "loss-
# resilient" profile that keeps the link up and lets the DLC retry
# across realistic interference bursts, while still bounding worst-
# case queue stall well below the 60 s stock default:
#
#   * SDU lifetime = 1.5 s (NRF_MODEM_DECT_DLC_SDU_LIFETIME_1_5_S = 21):
#     applied to the PT's flow_config[0] at association (the PT->FT
#     direction). In the typical tether scenario the PT sources data
#     toward the Internet, so PT->FT is the heavy uplink. 1.5 s is
#     large enough to absorb several DLC retransmission rounds across
#     short outages without dropping queued payload, but small enough
#     that a fundamentally broken link surfaces in seconds rather
#     than the ~minute that the 60 s stock default would impose.
#     Smaller values (10 ms..100 ms) are appropriate for latency-
#     sensitive workloads where stale SDUs are useless - tune at
#     runtime if needed.
#
#   * DLC-discard association release = off:
#     a DLC-discard timer expiry no longer tears down the association.
#     Stock default is on (one expiry => association release +
#     reconnect), which is fine for occasional bulk transfers but
#     causes unnecessary link flaps under bursty loss.
#
# The matching FT-side overlay (dect_shell) uses 2.5 s on its FT->PT
# flow; each side controls its own TX-flow lifetime, the two ends do
# NOT need to match.
#
# Both values are also runtime-tunable via the DECT L2 shell:
#   uart:~$ dect sett --dlc_sdu_lifetime 21
#   uart:~$ dect sett --dlc_discard_release_assoc off
#   uart:~$ dect sett --read    # to verify
#
# Valid sdu_lifetime values: 1..31 (0.5 ms..60 s, see
# enum dect_dlc_sdu_lifetime / nrf_modem_dect_dlc_sdu_lifetime) or 255
# for INFINITY.

CONFIG_DECT_MDM_NRF_DLC_SDU_LIFETIME=21
CONFIG_DECT_MDM_NRF_DLC_DISCARD_TIMER_RELEASE_ASSOCIATION=n
```

## eth_common.conf
```kconfig
# Copyright (c) 2026 Nordic Semiconductor ASA
#
# SPDX-License-Identifier: LicenseRef-Nordic-5-Clause
#
# Shared Ethernet shield Kconfig for dect_tether_ipv6 sample.
#
# EXTRA_CONF_FILE merge order (omit mDNS layers when not needed):
#   pt.conf | ft.conf -> eth_common.conf -> eth_w5500.conf | eth_link_board_eth.conf ->
#   mdns-common.conf -> mdns.conf -> eth_mdns.conf -> mdns_forward.conf -> optional extras
#
# From the sample directory (Ethernet only, no mDNS):
#   cd nrf/samples/dect/dect_tether_ipv6
#   west build -p -b nrf9151dk/nrf9151/ns -- \
#     -DSHIELD=arceli_eth_w5500 \
#     -DEXTRA_CONF_FILE="pt.conf;eth_common.conf;eth_w5500.conf" \
#     -DDTC_OVERLAY_FILE=w5500-static-mac.overlay
#
# For mDNS on eth, append mdns-common.conf, mdns.conf, eth_mdns.conf
# (and mdns_forward.conf for the eth0 <-> dect0 tap).
# For a random MAC each boot, use -DDTC_OVERLAY_FILE=w5500.overlay instead.
# For periodic unsolicited NA toward the tethered host, append eth_unsol_na.conf.
#
# Windows 11: RA-learned ::/0 often drops after ~30 s NUD. On the PC use a persistent
# static ::/0 (elevated PowerShell netsh) — see README "Optional static default
# gateway (Windows 11)". Or append eth_max_connectivity.conf (longer NUD interval).
#

# Unicast RA to RS source (RFC 4861); helps Windows install ::/0 at link-up.
CONFIG_DECT_TETHER_IPV6_RA_RS_UNICAST=y

CONFIG_SPI=y

CONFIG_ETH_DRIVER=y

CONFIG_NET_L2_ETHERNET=y
CONFIG_NET_L2_ETHERNET_MGMT=y

CONFIG_NET_L2_DECT_MTU=1500

# Using DECT and Ethernet RX threads
#CONFIG_NET_TC_TX_COUNT=0
#CONFIG_NET_TC_RX_COUNT=0

# Optimized for uplink traffic from DECT NR+ PT (=TX) via FT (=RX) to sink Ethernet
CONFIG_NRF_MODEM_LIB_SHMEM_TX_SIZE=30720
CONFIG_NRF_MODEM_LIB_SHMEM_RX_SIZE=12288

CONFIG_NET_PKT_TX_COUNT=10
CONFIG_NET_BUF_TX_COUNT=20

CONFIG_NET_PKT_RX_COUNT=30
CONFIG_NET_BUF_RX_COUNT=200

CONFIG_NET_LOG=y
CONFIG_ETHERNET_LOG_LEVEL_INF=y
CONFIG_NET_L2_ETHERNET_LOG_LEVEL_INF=y
# Surface "iface N pkt 0x... send failure status -E*" warnings (e.g. W5500 -EIO
# bursts) on this sample; otherwise net_if defaults below WRN and those
# warnings are silently dropped.
CONFIG_NET_IF_LOG_LEVEL_WRN=y

CONFIG_NET_MGMT_EVENT_QUEUE_SIZE=30

# dect0 + eth0
CONFIG_NET_IF_MAX_IPV6_COUNT=2
CONFIG_NET_IF_UNICAST_IPV6_ADDR_COUNT=3
CONFIG_NET_IF_IPV6_PREFIX_COUNT=3

CONFIG_DK_LIBRARY=n
```

## eth_link_board_eth.conf
```kconfig
# Copyright (c) 2026 Nordic Semiconductor ASA
#
# SPDX-License-Identifier: LicenseRef-Nordic-5-Clause
#

CONFIG_ETH_ENC424J600=y
CONFIG_ETH_ENC424J600_RX_THREAD_STACK_SIZE=3072
CONFIG_ETH_ENC424J600_RX_THREAD_PRIO=15
```

## eth_max_connectivity.conf
```kconfig
# Copyright (c) 2026 Nordic Semiconductor ASA
#
# SPDX-License-Identifier: LicenseRef-Nordic-5-Clause
#
# Maximum-connectivity timer overlay for dect_tether_ipv6.
#
# Include AFTER eth_common.conf to override its test-oriented defaults:
#   -DEXTRA_CONF_FILE="pt.conf;eth_common.conf;eth_w5500.conf;eth_max_connectivity.conf"
#
# DO NOT include eth_unsol_na.conf together with this file unless you need it.
#
# Long REACHABLE_TIME and router/DHCP lifetimes reduce how often hosts run NUD
# and how often router_lifetime must be refreshed. Periodic multicast RAs
# (RA_UNSOLICIT_MS, default 60 s) remain the only RA refresh path.

# RFC 4861 §6.2.1 maximum: 3 600 000 ms.
CONFIG_DECT_TETHER_IPV6_RA_REACHABLE_TIME_MS=3600000

# RFC 4861 §4.2 maximum: 65535 s (~18 h).
CONFIG_DECT_TETHER_IPV6_RA_ROUTER_LIFETIME=65535

# DHCPv6 lease timers aligned with a long-running session.
CONFIG_DECT_TETHER_IPV6_DHCPV6_ADDR_PREFERRED_LIFETIME=86400
CONFIG_DECT_TETHER_IPV6_DHCPV6_ADDR_VALID_LIFETIME=172800
CONFIG_DECT_TETHER_IPV6_DHCPV6_T1=1800
CONFIG_DECT_TETHER_IPV6_DHCPV6_T2=2880

# PIO lifetimes matched to DHCPv6 address lifetimes.
CONFIG_DECT_TETHER_IPV6_RA_PIO_PREFERRED_LIFETIME=86400
CONFIG_DECT_TETHER_IPV6_RA_PIO_VALID_LIFETIME=172800
```

## w5500-seeed-static-mac.overlay
```dts
/*
 * Copyright (c) 2026 Nordic Semiconductor ASA
 *
 * SPDX-License-Identifier: LicenseRef-Nordic-5-Clause
 */

#include <zephyr/dt-bindings/gpio/arduino-header-r3.h>

/*
 * Seeed W5500 Ethernet shield on nRF9151 DK (Zephyr shield seeed_w5500).
 *
 * Build (from the sample directory):
 *   cd nrf/samples/dect/dect_tether_ipv6
 *   west build -p -b nrf9151dk/nrf9151/ns -- \
 *     -DSHIELD=seeed_w5500 \
 *     -DEXTRA_CONF_FILE="eth_common.conf;eth_w5500.conf;eth_w5500_seeed.conf" \
 *     -DDTC_OVERLAY_FILE=w5500-seeed-static-mac.overlay
 *
 * MAC below is locally administered unicast (U/L bit set). Replace all six octets
 * per unit if several boards share one broadcast domain.
 *
 * INT pin: the WIZnet/Seeed W5500 shield routes the W5500 INTn to Arduino D2
 * through R25, and Rev 1.01 ships with R25 removed, so INTn never reaches a
 * header pin (and cannot be jumpered without soldering). Pair this overlay with
 * eth_w5500_seeed.conf, which runs the driver in poll mode
 * (CONFIG_ETH_W5500_POLL_MODE=y):
 * SENDOK/RX are serviced by polling over SPI, so no INTn wiring is needed - just
 * plug the shield in. The int-gpios property is still required by the binding;
 * point it at the stock D2 and add GPIO_PULL_UP so the unconnected pin idles
 * inactive and cannot raise spurious interrupts. If your unit has R25 populated
 * (real INTn on D2) you may drop poll mode and the GPIO_PULL_UP flag.
 */

&eth_w5500 {
	local-mac-address = [f6 ce 36 04 73 b1];
	int-gpios = <&arduino_header ARDUINO_HEADER_R3_D2 (GPIO_ACTIVE_LOW | GPIO_PULL_UP)>;
};
```

## w5500-seeed.overlay
```dts
/*
 * Copyright (c) 2026 Nordic Semiconductor ASA
 *
 * SPDX-License-Identifier: LicenseRef-Nordic-5-Clause
 */

#include <zephyr/dt-bindings/gpio/arduino-header-r3.h>

/*
 * Seeed W5500 Ethernet shield on nRF9151 DK (Zephyr shield seeed_w5500).
 *
 * Build (from the sample directory):
 *   cd nrf/samples/dect/dect_tether_ipv6
 *   west build -p -b nrf9151dk/nrf9151/ns -- \
 *     -DSHIELD=seeed_w5500 \
 *     -DEXTRA_CONF_FILE="eth_common.conf;eth_w5500.conf;eth_w5500_seeed.conf" \
 *     -DDTC_OVERLAY_FILE=w5500-seeed.overlay
 *
 * For a fixed MAC, use w5500-seeed-static-mac.overlay instead.
 *
 * INT pin: the WIZnet/Seeed W5500 shield routes the W5500 INTn to Arduino D2
 * through R25, and Rev 1.01 ships with R25 removed, so INTn never reaches a
 * header pin (and cannot be jumpered without soldering). Pair this overlay with
 * eth_w5500_seeed.conf, which runs the driver in poll mode
 * (CONFIG_ETH_W5500_POLL_MODE=y):
 * SENDOK/RX are serviced by polling over SPI, so no INTn wiring is needed - just
 * plug the shield in. The int-gpios property is still required by the binding;
 * point it at the stock D2 and add GPIO_PULL_UP so the unconnected pin idles
 * inactive and cannot raise spurious interrupts. If your unit has R25 populated
 * (real INTn on D2) you may drop poll mode and the GPIO_PULL_UP flag.
 */

&eth_w5500 {
	zephyr,random-mac-address;
	int-gpios = <&arduino_header ARDUINO_HEADER_R3_D2 (GPIO_ACTIVE_LOW | GPIO_PULL_UP)>;
};
```

## w5500-static-mac.overlay
```dts
/*
 * Copyright (c) 2026 Nordic Semiconductor ASA
 *
 * SPDX-License-Identifier: LicenseRef-Nordic-5-Clause
 */

/*
 * Arceli W5500 with fixed Ethernet MAC (alternative to w5500.overlay).
 *
 * Build: same as the Arceli Ethernet build but use this overlay instead:
 *   -DDTC_OVERLAY_FILE=w5500-static-mac.overlay
 *
 * MAC below is locally administered unicast (U/L bit set). Replace all six octets
 * per unit if several boards share one broadcast domain.
 */

&eth_w5500_arceli_eth_w5500 {
	local-mac-address = [f6 ce 36 04 73 b1];
	/* spi-max-frequency = <24000000>; */
};
```

## src/main.c
```c
/*
 * Copyright (c) 2026 Nordic Semiconductor ASA
 *
 * SPDX-License-Identifier: LicenseRef-Nordic-5-Clause
 */

#include <zephyr/kernel.h>
#include <zephyr/logging/log.h>
#include <zephyr/net/net_if.h>

#include <modem/nrf_modem_lib.h>
#include <nrf_modem.h>

#include <net/dect/dect_net_l2.h>

#include <dect_tether_ipv6.h>

#if defined(CONFIG_DK_LIBRARY)
#include <dk_buttons_and_leds.h>
#endif

LOG_MODULE_REGISTER(dect_tether_ipv6_sample, CONFIG_LOG_DEFAULT_LEVEL);

#if defined(CONFIG_DECT_DEFAULT_DEV_TYPE_FT)
#define DEVICE_TYPE_STR "FT"
#elif defined(CONFIG_DECT_DEFAULT_DEV_TYPE_PT)
#define DEVICE_TYPE_STR "PT"
#else
#error "Either CONFIG_DECT_DEFAULT_DEV_TYPE_FT or _PT must be defined."
#endif

void nrf_modem_fault_handler(struct nrf_modem_fault_info *fault_info)
{
	LOG_ERR("Modem fault: reason=%d, program_counter=0x%x", fault_info->reason,
		fault_info->program_counter);
	__ASSERT(false, "Modem crash detected, halting application");
}

int main(void)
{
	int err;
	struct net_if *dect;

	LOG_INF("=== DECT host-leg IPv6 sample (device type: %s) ===", DEVICE_TYPE_STR);

	dect = net_if_get_first_by_type(&NET_L2_GET_NAME(DECT));
	if (dect == NULL) {
		LOG_ERR("No DECT interface found");
		return -ENODEV;
	}

	err = nrf_modem_lib_init();
	if (err != 0) {
		LOG_ERR("nrf_modem_lib_init failed: %d", err);
		return err;
	}

#if defined(CONFIG_DK_LIBRARY)
	err = dk_leds_init();
	if (err != 0) {
		LOG_WRN("dk_leds_init failed: %d", err);
	}
#endif

	err = dect_tether_ipv6_init();
	if (err != 0) {
		LOG_ERR("dect_tether_ipv6_init failed: %d", err);
		return err;
	}

	LOG_INF("dect_tether_ipv6 active (RA + DHCPv6 per Kconfig)");
	return 0;
}
```

## src/mdns_dns_sd_listen.c
```c
/*
 * Copyright (c) 2026 Nordic Semiconductor ASA
 *
 * SPDX-License-Identifier: LicenseRef-Nordic-5-Clause
 *
 * Same pattern as samples/dect/dect_bridge_routing/src/mdns_dns_sd_listen.c and
 * samples/dect/dect_shell/src/mdns/dns_sd_listen.c: minimal UDP bind on dect0 so
 * Zephyr DNS-SD can advertise _dect-nr._udp (port must be bound). mDNS on UDP 5353
 * is handled by the stack (mdns_responder). IPv6 ADDR_ADD/DEL on dect0 triggers a
 * DNS-SD refresh so records track address changes after peer sync.
 */

#include <errno.h>
#include <string.h>

#include <zephyr/kernel.h>
#include <zephyr/logging/log.h>
#include <zephyr/net/dns_sd.h>
#include <zephyr/net/hostname.h>
#include <zephyr/net/mdns_responder.h>
#include <zephyr/net/net_if.h>
#include <zephyr/net/net_mgmt.h>
#include <zephyr/net/socket.h>
#include <zephyr/sys/byteorder.h>
#include <zephyr/sys/util.h>

LOG_MODULE_REGISTER(bh6_mdns, CONFIG_DECT_TETHER_IPV6_SAMPLE_LOG_LEVEL);

#define BH6_MDNS_IFACE_NAME "dect0"

static char bh6_dns_sd_instance[DNS_SD_INSTANCE_MAX_SIZE + 1];

static const uint16_t bh6_dns_sd_port_be =
	sys_cpu_to_be16((uint16_t)CONFIG_DECT_TETHER_IPV6_SAMPLE_MDNS_DNS_SD_PORT);

static struct dns_sd_rec bh6_dns_sd_rec = {
	.instance = bh6_dns_sd_instance,
	.service = "_dect-nr",
	.proto = "_udp",
	.domain = "local",
	.text = DNS_SD_EMPTY_TXT,
	.text_size = 0,
	.port = &bh6_dns_sd_port_be,
};

static K_MUTEX_DEFINE(bh6_dns_sd_mutex);

static void bh6_dns_sd_refresh(void)
{
	const char *h = net_hostname_get();
	size_t n = strlen(h);

	if (n > DNS_SD_INSTANCE_MAX_SIZE) {
		n = DNS_SD_INSTANCE_MAX_SIZE;
	}
	if (n < DNS_SD_INSTANCE_MIN_SIZE) {
		LOG_WRN("DNS-SD: hostname too short for instance label, skip");
		return;
	}

	k_mutex_lock(&bh6_dns_sd_mutex, K_FOREVER);
	memcpy(bh6_dns_sd_instance, h, n);
	bh6_dns_sd_instance[n] = '\0';
	(void)mdns_responder_set_ext_records(&bh6_dns_sd_rec, 1);
	k_mutex_unlock(&bh6_dns_sd_mutex);
}

static struct net_if *bh6_mdns_net_if(void)
{
	int idx = net_if_get_by_name(BH6_MDNS_IFACE_NAME);

	if (idx < 0) {
		return NULL;
	}

	return net_if_get_by_index(idx);
}

static bool bh6_mdns_iface_is_up(void)
{
	struct net_if *iface = bh6_mdns_net_if();

	return iface != NULL && net_if_flag_is_set(iface, NET_IF_UP);
}

static void bh6_dns_sd_listen_thread(void *p1, void *p2, void *p3)
{
	ARG_UNUSED(p1);
	ARG_UNUSED(p2);
	ARG_UNUSED(p3);

	int srv;
	struct sockaddr_in6 bind_addr = { 0 };
	uint8_t drain[128];
	struct net_if *dect_iface;
	struct net_ifreq if_req;
	char ifname[CONFIG_NET_INTERFACE_NAME_LEN + 1];

	bind_addr.sin6_family = AF_INET6;
	bind_addr.sin6_port = htons(CONFIG_DECT_TETHER_IPV6_SAMPLE_MDNS_DNS_SD_PORT);

	for (;;) {
		if (!bh6_mdns_iface_is_up()) {
			k_sleep(K_MSEC(500));
			continue;
		}

		dect_iface = bh6_mdns_net_if();
		if (dect_iface == NULL) {
			k_sleep(K_MSEC(500));
			continue;
		}

		srv = zsock_socket(AF_INET6, SOCK_DGRAM, IPPROTO_UDP);
		if (srv < 0) {
			LOG_ERR("DNS-SD stub: socket failed (%d)", errno);
			k_sleep(K_SECONDS(2));
			continue;
		}

		memset(&if_req, 0, sizeof(if_req));
		if (net_if_get_name(dect_iface, ifname, sizeof(ifname) - 1) >= 0) {
			memcpy(if_req.ifr_name, ifname,
			       MIN(sizeof(ifname) - 1, sizeof(if_req.ifr_name) - 1));
			if (zsock_setsockopt(srv, ZSOCK_SOL_SOCKET, ZSOCK_SO_BINDTODEVICE, &if_req,
					     sizeof(if_req)) < 0) {
				LOG_WRN("DNS-SD stub: SO_BINDTODEVICE failed (%d)", errno);
			}
		}

		if (zsock_bind(srv, (struct sockaddr *)&bind_addr, sizeof(bind_addr)) < 0) {
			LOG_WRN("DNS-SD stub: bind UDP %u failed (%d), retry",
				(unsigned int)CONFIG_DECT_TETHER_IPV6_SAMPLE_MDNS_DNS_SD_PORT,
				errno);
			zsock_close(srv);
			k_sleep(K_SECONDS(2));
			continue;
		}

		LOG_INF("DNS-SD: bound UDP %u on %s (_dect-nr._udp), instance=%s",
			(unsigned int)CONFIG_DECT_TETHER_IPV6_SAMPLE_MDNS_DNS_SD_PORT,
			BH6_MDNS_IFACE_NAME, net_hostname_get());
		break;
	}

	bh6_dns_sd_refresh();

	for (;;) {
		ssize_t n = zsock_recv(srv, drain, sizeof(drain), 0);

		if (n < 0) {
			LOG_WRN("DNS-SD stub: recv failed (%d)", errno);
			k_sleep(K_MSEC(200));
		}
	}
}

static void bh6_dns_sd_ipv6_evt(struct net_mgmt_event_callback *cb, uint64_t mgmt_event,
				struct net_if *iface)
{
	ARG_UNUSED(cb);

	if (mgmt_event != NET_EVENT_IPV6_ADDR_ADD && mgmt_event != NET_EVENT_IPV6_ADDR_DEL) {
		return;
	}

	if (iface != bh6_mdns_net_if()) {
		return;
	}

	bh6_dns_sd_refresh();
}

static struct net_mgmt_event_callback bh6_dns_sd_ipv6_cb;

static int bh6_dns_sd_net_mgmt_init(void)
{
	net_mgmt_init_event_callback(&bh6_dns_sd_ipv6_cb, bh6_dns_sd_ipv6_evt,
				     NET_EVENT_IPV6_ADDR_ADD | NET_EVENT_IPV6_ADDR_DEL);
	net_mgmt_add_event_callback(&bh6_dns_sd_ipv6_cb);
	return 0;
}

SYS_INIT(bh6_dns_sd_net_mgmt_init, APPLICATION, CONFIG_APPLICATION_INIT_PRIORITY);

K_THREAD_DEFINE(bh6_dns_sd_listen, 1536, bh6_dns_sd_listen_thread, NULL, NULL, NULL,
		K_PRIO_COOP(7), 0, 0);
```
