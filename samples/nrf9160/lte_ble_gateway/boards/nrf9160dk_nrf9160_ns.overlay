#include <nrf9160dk_nrf52840_reset_on_if5.dtsi>

/ {
	chosen {
		zephyr,bt-uart=&uart2;
	};
};

&gpiote {
	interrupts = <49 NRF_DEFAULT_IRQ_PRIORITY>;
};

&uart2 {
	current-speed = <1000000>;
	status = "okay";
	tx-pin = <18>; /* <&interface_to_nrf52840 1 0>; */
	rx-pin = <17>; /* <&interface_to_nrf52840 0 0>; */
	rts-pin = <21>; /* <&interface_to_nrf52840 3 0>; */
	cts-pin = <19>; /* <&interface_to_nrf52840 2 0>; */
	hw-flow-control;
};
