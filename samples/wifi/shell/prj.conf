## CMakeLists.txt
```
#
# Copyright (c) 2022 Nordic Semiconductor ASA
#
# SPDX-License-Identifier: LicenseRef-Nordic-5-Clause
#

cmake_minimum_required(VERSION 3.20.0)

find_package(Zephyr REQUIRED HINTS $ENV{ZEPHYR_BASE})
project(nrf_wifi_shell)

set(WIFI_NRF_DRV_BASE ${WEST_TOPDIR}/nrf/drivers/wifi/nrf700x)
if(CONFIG_WPA_SUPP)
set(WPA_SUPP_BASE ${WEST_TOPDIR}/modules/lib/hostap)
endif()

# TODO: MbedTLS Remove this workaround
target_include_directories_ifdef(CONFIG_MBEDTLS
	mbedcrypto_common
	INTERFACE
	${CMAKE_SOURCE_DIR}
)

target_sources(app PRIVATE
	src/wifi_main.c
)
```

## prj.conf
```kconfig
#
# Copyright (c) 2022 Nordic Semiconductor ASA
#
# SPDX-License-Identifier: LicenseRef-Nordic-5-Clause
#
CONFIG_WIFI=y
CONFIG_WIFI_NRF700X=y

# WPA supplicant
CONFIG_WPA_SUPP=y

# System settings
CONFIG_NEWLIB_LIBC=y
CONFIG_NEWLIB_LIBC_NANO=n

# Networking
CONFIG_NETWORKING=y
CONFIG_NET_SOCKETS=y
CONFIG_POSIX_API=y
CONFIG_NET_LOG=y
CONFIG_NET_IPV6=y
CONFIG_NET_IPV4=y
CONFIG_NET_UDP=y
CONFIG_NET_TCP=y
CONFIG_NET_DHCPV4=y
CONFIG_DNS_RESOLVER=y

CONFIG_NET_STATISTICS=y

CONFIG_NET_PKT_RX_COUNT=8
CONFIG_NET_PKT_TX_COUNT=8

CONFIG_LOCATION=y
CONFIG_LOCATION_METHOD_GNSS=n
CONFIG_LOCATION_METHOD_CELLULAR=n
CONFIG_LOCATION_METHOD_WIFI=y
#CONFIG_NRF_CLOUD_REST=y
CONFIG_LOCATION_METHOD_WIFI_SERVICE_HERE=y
CONFIG_LOCATION_METHOD_WIFI_SERVICE_HERE_API_KEY="vteBD6E_xVPF6twxv9ZehnqrUDS0Bi9nyj4XsCoRTPY"
CONFIG_LOCATION_LOG_LEVEL_DBG=y
CONFIG_NEWLIB_LIBC=y
CONFIG_NEWLIB_LIBC_FLOAT_PRINTF=y
CONFIG_REST_CLIENT_LOG_LEVEL_DBG=y


#CONFIG_CJSON_LIB=y
#CONFIG_NET_SHELL=y
#CONFIG_NET_L2_WIFI_SHELL=y

# Below section is the primary contributor to SRAM and is currently
# tuned for performance, but this will be revisited in the future.
CONFIG_NET_BUF_RX_COUNT=16
CONFIG_NET_BUF_TX_COUNT=16
CONFIG_NET_BUF_DATA_SIZE=128
CONFIG_HEAP_MEM_POOL_SIZE=153600
CONFIG_NET_TC_TX_COUNT=0

CONFIG_NET_IF_UNICAST_IPV6_ADDR_COUNT=4
CONFIG_NET_IF_MCAST_IPV6_ADDR_COUNT=5
CONFIG_NET_IF_UNICAST_IPV4_ADDR_COUNT=1
CONFIG_NET_MAX_CONTEXTS=5
CONFIG_NET_CONTEXT_SYNC_RECV=y

CONFIG_INIT_STACKS=y

CONFIG_NET_L2_ETHERNET=y
CONFIG_NET_SHELL=y

CONFIG_NET_CONFIG_SETTINGS=y
CONFIG_NET_CONFIG_MY_IPV6_ADDR="2001:db8::1"
CONFIG_NET_CONFIG_PEER_IPV6_ADDR="2001:db8::2"
CONFIG_NET_CONFIG_MY_IPV4_ADDR="192.165.100.150"
CONFIG_NET_CONFIG_PEER_IPV4_ADDR="192.165.100.1"

CONFIG_NET_SOCKETS_POLL_MAX=4

# Memories
CONFIG_MAIN_STACK_SIZE=4096
CONFIG_SHELL_STACK_SIZE=4096
CONFIG_SYSTEM_WORKQUEUE_STACK_SIZE=2048
CONFIG_NET_TX_STACK_SIZE=4096
CONFIG_NET_RX_STACK_SIZE=4096

# Debugging
CONFIG_STACK_SENTINEL=y
CONFIG_DEBUG_COREDUMP=y
CONFIG_DEBUG_COREDUMP_BACKEND_LOGGING=y
CONFIG_DEBUG_COREDUMP_MEMORY_DUMP_MIN=y
CONFIG_SHELL_CMDS_RESIZE=n
#CONFIG_DEBUG=y

# Kernel options
CONFIG_ENTROPY_GENERATOR=y

# Logging
CONFIG_LOG=y
CONFIG_PRINTK=y
CONFIG_SHELL=y
CONFIG_SHELL_GETOPT=y
CONFIG_DEVICE_SHELL=y
CONFIG_POSIX_CLOCK=y
CONFIG_DATE_SHELL=y

# Security
# CONFIG_CRYPTO_MBEDTLS_SHIM=y
CONFIG_ENTROPY_GENERATOR=y
CONFIG_MBEDTLS=y
CONFIG_NORDIC_SECURITY_BACKEND=y
CONFIG_HARDWARE_DEVICE_CS_GENERATOR=y
# TODO: We need to get it working with a standard configuration file
CONFIG_GENERATE_MBEDTLS_CFG_FILE=n
CONFIG_MBEDTLS_PSA_CRYPTO_EXTERNAL_RNG=n
# Need this for CTR_DBRG and ENTROPY
CONFIG_MBEDTLS_CFG_FILE="src/nrf-config.h"
CONFIG_MBEDTLS_USER_CONFIG_FILE="src/nrf-config-user.h"
# To fix Kconfig MD5 warning
CONFIG_NET_TCP_ISN_RFC6528=n
```

## overlay-wifi-location-nrf-cloud-mqtt.conf
```kconfig
CONFIG_SHELL_PROMPT_UART="wilosh:~$ "

CONFIG_NRF_CLOUD_MQTT=y
CONFIG_NRF_CLOUD_CLIENT_ID="nrf-wifi-f4ce3600008c"
#CONFIG_NRF_CLOUD_CLIENT_ID="nrf-wifi-f4ce000084"
CONFIG_NRF_CLOUD_CLIENT_ID_SRC_COMPILE_TIME=y
CONFIG_NRF_CLOUD_REST=n
CONFIG_NRF_CLOUD_MQTT_MESSAGE_BUFFER_LEN=8192
CONFIG_NRF_CLOUD_MQTT_PAYLOAD_BUFFER_LEN=8192
CONFIG_NRF_CLOUD_MQTT_SHELL=y
CONFIG_NRF_CLOUD_FOTA=n
CONFIG_NRF_CLOUD_PROVISION_CERTIFICATES=y
CONFIG_NRF_CLOUD_CONNECTION_POLL_THREAD=y
CONFIG_NRF_CLOUD_SEC_TAG=1
CONFIG_MQTT_CLEAN_SESSION=y
CONFIG_MQTT_LIB_TLS=y

CONFIG_NET_BUF_RX_COUNT=64
CONFIG_NET_BUF_TX_COUNT=64

#CONFIG_NRF_CLOUD_LOG_LEVEL_DBG=y
#CONFIG_NET_LOG=y
#CONFIG_MQTT_LOG_LEVEL_DBG=y
#CONFIG_NET_SOCKETS_LOG_LEVEL_DBG=y
#CONFIG_NET_CONTEXT_LOG_LEVEL_DBG=y

CONFIG_LOCATION=y
#CONFIG_LOCATION_LOG_LEVEL_DBG=y
CONFIG_LOCATION_METHOD_GNSS=n
CONFIG_LOCATION_METHOD_CELLULAR=n
CONFIG_LOCATION_METHOD_WIFI=y
CONFIG_LOCATION_METHOD_WIFI_SERVICE_NRF_CLOUD=y
CONFIG_LOCATION_METHOD_WIFI_SCANNING_RESULTS_MAX_CNT=35
CONFIG_DATE_TIME=y
CONFIG_DATE_TIME_LOG_LEVEL_DBG=y

#CONFIG_DNS_RESOLVER_LOG_LEVEL_DBG=y
CONFIG_NET_SOCKETS_DNS_TIMEOUT=10000
CONFIG_DNS_SERVER_IP_ADDRESSES=y
#CONFIG_DNS_SERVER1="8.8.8.8"

CONFIG_NEWLIB_LIBC=y
CONFIG_NEWLIB_LIBC_FLOAT_PRINTF=y
CONFIG_FPU=y
CONFIG_NET_TCP_WORKQ_STACK_SIZE=8192
CONFIG_NET_SOCKETS_SOCKOPT_TLS=y
CONFIG_NET_CONTEXT_CHECK=n
CONFIG_NET_SOCKETS_TLS_MAX_CONTEXTS=2
CONFIG_NET_SOCKETS_TLS_SET_MAX_FRAGMENT_LENGTH=y

# Increase extra FD entry for TLS contexts(2)
CONFIG_POSIX_MAX_FDS=12

CONFIG_MBEDTLS=y

#CONFIG_NORDIC_SECURITY_BACKEND=n
#CONFIG_MBEDTLS_BUILTIN=y
CONFIG_MBEDTLS_TLS_LIBRARY=y
CONFIG_MBEDTLS_ENABLE_HEAP=y
#CONFIG_MBEDTLS_DEBUG=y
#CONFIG_MBEDTLS_DEBUG_LEVEL=4
CONFIG_MBEDTLS_SSL_IN_CONTENT_LEN=16384
CONFIG_MBEDTLS_SSL_OUT_CONTENT_LEN=16384
CONFIG_MBEDTLS_HEAP_SIZE=120000
CONFIG_MBEDTLS_SSL_SERVER_NAME_INDICATION=y
CONFIG_MBEDTLS_X509_CSR_WRITE_C=y
CONFIG_MBEDTLS_SSL_DEBUG_ALL=y
CONFIG_MBEDTLS_ENTROPY_ENABLED=y
CONFIG_MBEDTLS_KEY_EXCHANGE_ECDHE_ECDSA_ENABLED=y
CONFIG_MBEDTLS_ECP_ALL_ENABLED=y

#Cipher Suite disable
CONFIG_MBEDTLS_CTR_DRBG_C=n
CONFIG_MBEDTLS_CHACHA20_C=n
CONFIG_MBEDTLS_POLY1305_C=n
CONFIG_MBEDTLS_SHA1_C=n
CONFIG_MBEDTLS_DHM_C=n
CONFIG_MBEDTLS_CMAC_C=n
CONFIG_MBEDTLS_CIPHER_MODE_CTR=n
CONFIG_MBEDTLS_CIPHER_MODE_CFB=n
CONFIG_MBEDTLS_CIPHER_MODE_OFB=n
CONFIG_MBEDTLS_KEY_EXCHANGE_DHE_PSK_ENABLED=n
CONFIG_MBEDTLS_KEY_EXCHANGE_DHE_RSA_ENABLED=n

#Cipher Suite enable
CONFIG_MBEDTLS_ECDSA_DETERMINISTIC=y
CONFIG_MBEDTLS_SHA512_C=y
CONFIG_MBEDTLS_ECDH_C=y
CONFIG_MBEDTLS_SSL_SRV_C=y
CONFIG_MBEDTLS_AES_C=y
CONFIG_MBEDTLS_CCM_C=y
CONFIG_MBEDTLS_PKCS1_V15=y
##########################
#CONFIG_CJSON_LIB=y
#CONFIG_NET_SHELL=y
#CONFIG_NET_L2_WIFI_SHELL=y

#Following selects MBEDTLS_MAC_MD5_ENABLED that needs bunch of other features
CONFIG_NET_TCP_ISN_RFC6528=n

#Default RTO is too short and causes spurious retransmissions in uplink
CONFIG_NET_TCP_INIT_RETRANSMISSION_TIMEOUT=1500
CONFIG_NET_TCP_RETRY_COUNT=6
```

## overlay-wifi-location.conf
```kconfig
#CONFIG_DNS_RESOLVER_LOG_LEVEL_DBG=y
CONFIG_NET_SOCKETS_DNS_TIMEOUT=10000
CONFIG_DNS_SERVER_IP_ADDRESSES=y
CONFIG_DNS_SERVER1="8.8.8.8"

CONFIG_LOCATION=y
CONFIG_LOCATION_METHOD_GNSS=n
CONFIG_LOCATION_METHOD_CELLULAR=n
CONFIG_LOCATION_METHOD_WIFI=y
CONFIG_NRF_CLOUD_REST=n
CONFIG_LOCATION_METHOD_WIFI_SERVICE_HERE=y
CONFIG_LOCATION_METHOD_WIFI_SERVICE_HERE_API_KEY="ENTER YOUR API KEY HERE"
#CONFIG_LOCATION_LOG_LEVEL_DBG=y
CONFIG_NEWLIB_LIBC=y
CONFIG_NEWLIB_LIBC_FLOAT_PRINTF=y
CONFIG_FPU=y

#CONFIG_NEWLIB_LIBC_FLOAT_SCANF=y
# Enable use of vsnprintfcb() for extending mosh_print() format
CONFIG_CBPRINTF_LIBC_SUBSTS=y
#CONFIG_REST_CLIENT_LOG_LEVEL_DBG=y

CONFIG_NET_TCP_WORKQ_STACK_SIZE=8192
CONFIG_NET_SOCKETS_SOCKOPT_TLS=y
CONFIG_NET_CONTEXT_CHECK=n
CONFIG_NET_SOCKETS_TLS_MAX_CONTEXTS=2
CONFIG_NET_SOCKETS_TLS_SET_MAX_FRAGMENT_LENGTH=y

# Increase extra FD entry for TLS contexts(2)
CONFIG_POSIX_MAX_FDS=12

CONFIG_MBEDTLS=y
CONFIG_MBEDTLS_SHELL=y
CONFIG_MBEDTLS_TLS_LIBRARY=y
CONFIG_MBEDTLS_ENABLE_HEAP=y
CONFIG_MBEDTLS_SSL_IN_CONTENT_LEN=16384
CONFIG_MBEDTLS_SSL_OUT_CONTENT_LEN=16384
CONFIG_MBEDTLS_HEAP_SIZE=120000
CONFIG_MBEDTLS_SSL_SERVER_NAME_INDICATION=y

#Cipher Suite disable
CONFIG_MBEDTLS_CTR_DRBG_C=n
CONFIG_MBEDTLS_CHACHA20_C=n
CONFIG_MBEDTLS_POLY1305_C=n
CONFIG_MBEDTLS_SHA1_C=n
CONFIG_MBEDTLS_DHM_C=n
CONFIG_MBEDTLS_CMAC_C=n
CONFIG_MBEDTLS_CIPHER_MODE_CTR=n
CONFIG_MBEDTLS_CIPHER_MODE_CFB=n
CONFIG_MBEDTLS_CIPHER_MODE_OFB=n
CONFIG_MBEDTLS_KEY_EXCHANGE_DHE_PSK_ENABLED=n
CONFIG_MBEDTLS_KEY_EXCHANGE_DHE_RSA_ENABLED=n

#Cipher Suite enable
CONFIG_MBEDTLS_ECDSA_DETERMINISTIC=y
CONFIG_MBEDTLS_SHA512_C=y
CONFIG_MBEDTLS_ECDH_C=y
CONFIG_MBEDTLS_SSL_SRV_C=y
CONFIG_MBEDTLS_AES_C=y
CONFIG_MBEDTLS_CCM_C=y
CONFIG_MBEDTLS_PKCS1_V15=y
##########################
#CONFIG_CJSON_LIB=y
#CONFIG_NET_SHELL=y
#CONFIG_NET_L2_WIFI_SHELL=y
```

## src/wifi_main.c
```c
/*
 * Copyright (c) 2012-2014 Wind River Systems, Inc.
 *
 * SPDX-License-Identifier: Apache-2.0
 */

#include <zephyr/sys/printk.h>
#include <nrfx_clock.h>
#if defined(CONFIG_LOCATION)
#include "location_shell.h"
#endif

void main(void)
{
#ifdef CLOCK_FEATURE_HFCLK_DIVIDE_PRESENT
	/* For now hardcode to 128MHz */
	nrfx_clock_divider_set(NRF_CLOCK_DOMAIN_HFCLK,
			       NRF_CLOCK_HFCLK_DIV_1);
#endif
#if defined(CONFIG_LOCATION)
	cmd_loc_init();
#endif
	printk("Starting %s with CPU frequency: %d MHz\n", CONFIG_BOARD, SystemCoreClock/MHZ(1));
}
```

## src/wifi_shell.c
```c
/*
 * Copyright (c) 2022 Nordic Semiconductor ASA
 *
 * SPDX-License-Identifier: LicenseRef-Nordic-5-Clause
 */

/* @file
 * @brief Wi-Fi shell sample
 */

#include <stdio.h>
#include <stdlib.h>
#include <ctype.h>

#include <zephyr/zephyr.h>
#include <zephyr/shell/shell.h>
#include <zephyr/init.h>

#include <net/net_if.h>
#include <net/wifi_mgmt.h>
#include <net/net_event.h>
#include <zephyr_fmac_main.h>

#ifdef CONFIG_WPA_SUPP
#include <src/utils/common.h>
#include <wpa_supplicant/config.h>
#include <wpa_supplicant/wpa_supplicant_i.h>

#include "supp_main.h"
#endif /* CONFIG_WPA_SUPP */

#include "zephyr_disp_scan.h"

static struct {
	const struct shell *shell;

	union {
		struct {
			uint8_t connecting : 1;
			uint8_t disconnecting : 1;
			uint8_t _unused : 6;
		};
		uint8_t all;
	};
} context;

static uint32_t scan_result;

int cli_main(int argc, const char **argv);

extern struct wpa_global *global;

/* TODO: Take this an input from shell */
static const char *if_name = "wlan0";

struct wpa_ssid *ssid_0;

#define MAX_SSID_LEN 32


static void scan_result_cb(struct net_if *iface,
			   int status,
			   struct wifi_scan_result *entry)
{
	if (!iface) {
		return;
	}

	if (!entry) {
		if (status) {
			shell_fprintf(context.shell,
				      SHELL_WARNING,
				      "Scan request failed (%d)\n",
				      status);
		} else {
			shell_fprintf(context.shell,
				      SHELL_NORMAL,
				      "Scan request done\n");
		}

		return;
	}

	scan_result++;

	if (scan_result == 1U) {
		shell_fprintf(context.shell,
			      SHELL_NORMAL,
			      "\n%-4s | %-32s %-5s | %-4s | %-4s | %-5s\n", "Num", "SSID",
			      "(len)", "Chan", "RSSI", "Sec");
	}

	shell_fprintf(context.shell,
		      SHELL_NORMAL,
		      "%-4d | %-32s %-5u | %-4u | %-4d | %-5s\n",
		      scan_result,
		      entry->ssid,
		      entry->ssid_length,
		      entry->channel,
		      entry->rssi,
		      (entry->security == WIFI_SECURITY_TYPE_PSK ? "WPA/WPA2" : "Open"));
}


static int cmd_wifi_scan(const struct shell *shell,
			       size_t argc,
			       const char *argv[])
{
	struct net_if *iface = net_if_get_default();
	const struct device *dev = net_if_get_device(iface);
	const struct wifi_nrf_dev_ops *dev_ops = dev->api;

	context.shell = shell;

	return dev_ops->off_api.disp_scan(dev,
					  scan_result_cb);
}


#ifdef CONFIG_WPA_SUPP
static int __wifi_args_to_params(size_t argc,
				 const char *argv[],
				 struct wifi_connect_req_params *params)
{
	char *endptr;
	int idx = 1;

	if (argc < 1) {
		return -EINVAL;
	}

	/* SSID */
	params->ssid = (char *)argv[0];
	params->ssid_length = strlen(params->ssid);

	/* PSK (optional) */
	if (idx < argc) {
		params->psk = (char *)argv[idx];
		params->psk_length = strlen(argv[idx]);
		params->security = WIFI_SECURITY_TYPE_PSK;
		idx++;

		if ((idx < argc) && (strlen(argv[idx]) <= 2)) {
			params->security = strtol(argv[idx], &endptr, 10);
		}
	} else {
		params->security = WIFI_SECURITY_TYPE_NONE;
	}

	return 0;
}

static int send_wpa_supplicant_dummy_event(void)
{
	struct wpa_supplicant_event_msg msg = { 0 };

	msg.ignore_msg = true;
	wpa_printf(MSG_INFO, "Msg:Dummy, size: %d", sizeof(msg));

	return send_wpa_supplicant_event(&msg);
}


static int cmd_supplicant_connect(const struct shell *shell,
				  size_t argc,
				  const char *argv[])
{
	static struct wifi_connect_req_params cnx_params;
	struct wifi_connect_req_params *params;
	struct wpa_ssid *ssid = NULL;
	bool pmf = true;
	struct wpa_supplicant *wpa_s;

	if (__wifi_args_to_params(argc - 1,
				  &argv[1],
				  &cnx_params)) {
		shell_help(shell);
		return -ENOEXEC;
	}

	params = &cnx_params;

	wpa_s = wpa_supplicant_get_iface(global, if_name);
	if (!wpa_s) {
		shell_fprintf(context.shell,
			      SHELL_ERROR,
			      "%s: wpa_supplicant is not initialized, dropping connect\n",
			      __func__);
		return -1;
	}

	ssid = wpa_supplicant_add_network(wpa_s);
	ssid->ssid = os_zalloc(sizeof(u8) * MAX_SSID_LEN);

	memcpy(ssid->ssid, params->ssid, params->ssid_length);
	ssid->ssid_len = params->ssid_length;
	ssid->disabled = 1;
	ssid->key_mgmt = WPA_KEY_MGMT_NONE;

	wpa_s->conf->filter_ssids = 1;
	wpa_s->conf->ap_scan = 1;

	if (params->psk) {
		// TODO: Extend enum wifi_security_type
		if (params->security == 3) {
			ssid->key_mgmt = WPA_KEY_MGMT_SAE;
			str_clear_free(ssid->sae_password);
			ssid->sae_password = dup_binstr(params->psk, params->psk_length);

			if (ssid->sae_password == NULL) {
				shell_fprintf(context.shell,
					      SHELL_ERROR,
					      "%s:Failed to copy sae_password\n",
					      __func__);
				return -1;
			}
		} else {
			if (params->security == 2)
				ssid->key_mgmt = WPA_KEY_MGMT_PSK_SHA256;
			else
				ssid->key_mgmt = WPA_KEY_MGMT_PSK;

			str_clear_free(ssid->passphrase);
			ssid->passphrase = dup_binstr(params->psk, params->psk_length);

			if (ssid->passphrase == NULL) {
				shell_fprintf(context.shell,
					      SHELL_ERROR,
					      "%s:Failed to copy passphrase\n",
					      __func__);
				return -1;
			}
		}

		wpa_config_update_psk(ssid);

		if (pmf)
			ssid->ieee80211w = 1;

	}

	wpa_supplicant_enable_network(wpa_s,
				      ssid);

	wpa_supplicant_select_network(wpa_s,
				      ssid);

	send_wpa_supplicant_dummy_event();

	return 0;
}


static int cmd_supplicant(const struct shell *shell,
			  size_t argc,
			  const char *argv[])
{
	int ret;
	struct wpa_supplicant *wpa_s = wpa_supplicant_get_iface(global, if_name);

	if (!wpa_s) {
		shell_fprintf(shell,
			SHELL_ERROR,
			"%s: wpa_supplicant is not initialized, dropping connect\n",
			__func__);
		return -1;
	}

	ret =  cli_main(argc, argv);
	if (!ret) {
		send_wpa_supplicant_dummy_event();
	}

	return ret;
}
#endif /* CONFIG_WPA_SUPP */


SHELL_STATIC_SUBCMD_SET_CREATE(
	wpa_cli_cmds,
	SHELL_CMD(scan,
		  NULL,
		  "Scan AP",
		  cmd_wifi_scan),
#ifdef CONFIG_WPA_SUPP
	SHELL_CMD(connect,
		  NULL,
		  " \"<SSID>\""
		  "\nPassphrase (optional: valid only for secured SSIDs)>"
		  "\nKEY_MGMT (optional: 0-None, 1-WPA2, 2-WPA2-256, 3-WPA3)",
		  cmd_supplicant_connect),
	SHELL_CMD(add_network,
		  NULL,
		  "\"Add Network network id/number\"",
		  cmd_supplicant),
	SHELL_CMD(set_network,
		  NULL,
		  "\"Set Network params\"",
		  cmd_supplicant),
	SHELL_CMD(set,
		  NULL,
		  "\"Set Global params\"",
		  cmd_supplicant),
	SHELL_CMD(get,
		  NULL, "\"Get Global params\"",
		  cmd_supplicant),
	SHELL_CMD(enable_network,
		  NULL,
		  "\"Enable Network\"",
		  cmd_supplicant),
	SHELL_CMD(remove_network,
		  NULL,
		  "\"Remove Network\"",
		  cmd_supplicant),
	SHELL_CMD(get_network,
		  NULL,
		  "\"Get Network\"",
		  cmd_supplicant),
	SHELL_CMD(select_network,
		  NULL,
		  "\"Select Network which will be enabled; rest of the networks will be disabled\"",
		  cmd_supplicant),
	SHELL_CMD(disable_network,
		  NULL,
		  "\"\"",
		  cmd_supplicant),
	SHELL_CMD(disconnect,
		  NULL,
		  "\"\"",
		  cmd_supplicant),
	SHELL_CMD(reassociate,
		  NULL,
		  "\"\"",
		  cmd_supplicant),
	SHELL_CMD(status,
		  NULL,
		  "\"Get client status\"",
		  cmd_supplicant),
	SHELL_CMD(bssid,
		  NULL,
		  "\"Associate with this BSSID\"",
		  cmd_supplicant),
	SHELL_CMD(sta_autoconnect,
		  NULL,
		  "\"\"",
		  cmd_supplicant),
	SHELL_CMD(signal_poll,
		  NULL,
		  "\"\"",
		  cmd_supplicant),
#endif /* CONFIG_WPA_SUPP */
	SHELL_SUBCMD_SET_END);

/* Persisting with "wpa_cli" naming for compatibility with Wi-Fi
 * certification applications and scripts.
 */
SHELL_CMD_REGISTER(wpa_cli,
		   &wpa_cli_cmds,
		   "Wi-Fi commands",
		   NULL);


static int wifi_shell_init(const struct device *unused)
{
	ARG_UNUSED(unused);

	context.shell = NULL;
	context.all = 0U;
	scan_result = 0U;

	return 0;
}


SYS_INIT(wifi_shell_init,
	 APPLICATION,
	 CONFIG_KERNEL_INIT_PRIORITY_DEFAULT);
```
