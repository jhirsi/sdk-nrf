## drivers/dect/dect_mdm/Kconfig
```kconfig
# Copyright (c) 2025 Nordic Semiconductor ASA
#
# SPDX-License-Identifier: LicenseRef-Nordic-5-Clause

menu "Nordic driver specific configs for DECT NR+"

config DECT_MDM_NRF
	bool "Nordic-specific DECT MDM driver configurations"
	depends on DECT_MDM
	default y if DECT_MDM_DRIVER_NRF
	help
	  Enable Nordic-specific configuration options for the DECT MDM driver.
	  This includes RX RSSI settings, TX flow control, and thread stack sizes
	  optimized for Nordic nRF91-based DECT modems.

if DECT_MDM_NRF

config DECT_MDM_NRF_RX_MCS1_EXPECTED_RSSI_LEVEL
	int "Expected RSSI level for MCS1"
	default -68
	range -128 0
	help
	  RX RSSI level for power control in modem, value in dBm.
	  Device expects to receive transmissions (MCS#1) at this RSSI level.

config NET_LINK_ADDR_CUSTOM_LENGTH
	int "Size of custom link layer address length for DECT NR+"
	default 8

config DECT_MDM_NRF_TX_FLOW_CTRL_BASED_ON_MDM_TX_DLC_REQS
	bool "TX flow control support"
	default y
	help
	  Enable TX window based flow ctrl on unacked mdm TX DLC data requests.

config DECT_MDM_NRF_DLC_DISCARD_TIMER_RELEASE_ASSOC_COUNT
	int "DLC discard timer expiries before association release"
	depends on DECT_MDM_NRF_TX_FLOW_CTRL_BASED_ON_MDM_TX_DLC_REQS
	range 0 255
	default 1
	help
	  When a DLC data TX response returns
	  NRF_MODEM_DECT_MAC_STATUS_DLC_DISCARD_TIMER_EXPIRED, count consecutive
	  expiries per peer before releasing the association with cause
	  NRF_MODEM_DECT_MAC_RELEASE_CAUSE_BAD_RADIO_QUALITY. The counter resets
	  on a successful DLC TX response to that peer. 0 disables association
	  release on discard-timer expiry (upper layers decide). Valid range
	  1..255 when enabled. Values greater than 1 compile in per-peer
	  expiry counting.

config DECT_MDM_NRF_DLC_DISCARD_TIMER_RELEASE_ASSOC_PEER_TRACKING
	def_bool DECT_MDM_NRF_DLC_DISCARD_TIMER_RELEASE_ASSOC_COUNT > 1
	depends on DECT_MDM_NRF_TX_FLOW_CTRL_BASED_ON_MDM_TX_DLC_REQS

config DECT_MDM_NRF_DLC_SDU_LIFETIME
	int "DLC SDU discard-timer (lifetime) for PT->FT data flow"
	range 1 255
	default 31
	help
	  Initial default for the DLC SDU discard-timer used on the PT->FT data
	  flow at association. Holds an enum nrf_modem_dect_dlc_sdu_lifetime
	  value: 1..31 for fixed durations (0.5 ms..60 s, e.g. 31 = 60 s),
	  255 for INFINITY. Other values in 32..254 are invalid and rejected
	  at runtime.

config DECT_MDM_NRF_CTRL_THREAD_STACK_SIZE
	int "Driver's internal ctrl thread stack size"
	default 3072
	help
	  This option sets the driver's stack size for its internal ctrl thread.
	  Note: Most probably, you might decrease this if size of net mgmt events
	  are decreased.

rsource "Kconfig.rx"

endif # DECT_MDM_NRF

endmenu
```

## drivers/dect_nrp/Kconfig
```kconfig
menu "Common configs for DECT NR+ mac"

config DECT_NRP_MAC
	bool "Common configs for DECT NR+ modem mac"
	depends on NRF_MODEM_VARIANT_DECT_MAC
	depends on SETTINGS
	select NET_L2_DECT
	select NET_L2_DECT_MGMT
	select DECT_NRP_LIB
	help
	  dect nr+ modem mac configs.

if DECT_NRP_MAC

#Select actual driver
choice DECT_NRP_MAC_DRIVER
	prompt "Select DECT NR+ modem mac driver"
	default DECT_NRP_MAC_DRIVER_NRF

	config DECT_NRP_MAC_DRIVER_NRF
		bool "nrf91 mac driver"
endchoice

choice DECT_NRP_MAC_DEFAULT_DEV_TYPE
	prompt "Select default device type"
	default DECT_NRP_MAC_DEFAULT_DEV_TYPE_PT

	config DECT_NRP_MAC_DEFAULT_DEV_TYPE_PT
		bool "PT device type"

	config DECT_NRP_MAC_DEFAULT_DEV_TYPE_FT
		bool "FT device type"
endchoice

config DECT_NRP_MAC_DEFAULT_NW_ID
	hex "Default nw id"
	default 0x87654321
	help
	  Default nw id.

choice DECT_NRP_MAC_DEFAULT_LONG_RD_ID_TYPE
	prompt "Select default long rd id type"
	default DECT_NRP_MAC_DEFAULT_LONG_RD_ID_TYPE_RANDOM
config DECT_NRP_MAC_DEFAULT_LONG_RD_ID_TYPE_HARD_CODED
	bool "Default long rd id as hard coded"
	help
	  Default long rd id is hard coded.

config DECT_NRP_MAC_DEFAULT_LONG_RD_ID_TYPE_RANDOM
	bool "Default long rd id as random generated"
	help
	  Default long rd id is randomly generated at 1st bootup and later in settings reset.
endchoice

config DECT_NRP_MAC_DEFAULT_LONG_RD_ID
	int "Default long rd id"
	range 1 4294967293
	default 666
	help
	  Default long rd id used if DECT_NRP_MAC_DEFAULT_LONG_RD_ID_TYPE_HARD_CODED is selected.

config DECT_NRP_MAC_CLUSTER_MAX_CHILD_ASSOCIATION_COUNT
	int "Maximum number of associations"
	default 50

config DECT_NRP_MAC_BORDER_ROUTER
	bool "Enable border router support for DECT NR+"
	default y if NET_L2_ETHERNET || MODEM_CELLULAR
	select NET_ROUTING if NET_IPV6 && NET_ROUTE
	help
	  Enable Border Router (BR) support.
	  SLM running with LTE connection in connected nrf9151DK accessed via
	  PPP by using MODEM_CELLULAR feature (preferred option),
	  or Ethernet based NET_L2_ETHERNET mode can be used as a border router.
	  If MODEM_CELLULAR is selected, then BR has only one sink and vice versa.

config DECT_NRP_MAC_NET_IF_NO_AUTO_START
	bool "Enable interface auto-start"
	default y if NET_L2_DECT_CONN_MGR_AUTO_CONNECT
	help
	  This option allows user to disable autostarting of the net interface
	  immediately after initialization and instead call for net_if_up()
	  manually.

module = DECT_NRP_MAC
module-dep = LOG
module-str = Log level for dect nr+ nrf91 driver
source "${ZEPHYR_BASE}/subsys/logging/Kconfig.template.log_config"

#Include vendor specifics
if DECT_NRP_MAC_DRIVER_NRF
rsource "nrf91_mac/Kconfig"
endif # DECT_NRP_MAC_DRIVER_NRF
endif # DECT_NRP_MAC

endmenu
```

## drivers/dect_nrp/nrf91_mac/Kconfig
```kconfig
menu "Nordic driver specific configs for DECT NR+ modem mac"

config DECT_NRP_MAC_NRF
	bool "Nordic driver specific configs for DECT NR+ modem mac"
	depends on NRF_MODEM_VARIANT_DECT_MAC
	depends on SETTINGS
	default y if DECT_NRP_MAC_DRIVER_NRF
	select NET_L2_DECT
	select NET_L2_DECT_MGMT
	select DECT_NRP_LIB
	help
	  Nordic specific dect nr+ modem mac configs.

if DECT_NRP_MAC_NRF

config DECT_NRP_MAC_NRF_RX_MCS1_EXPECTED_RSSI_LEVEL
	int "Expected RSSI level for MCS1"
	default -68
	range -128 0
	help
	  RX RSSI level for power control in modem, value in dBm.
	  Device expects to receive transmissions (MCS#1) at this RSSI level.

config NET_LINK_ADDR_CUSTOM_LENGTH
	int "Size of custom link layer address length for DECT NR+"
	default 8

config DECT_NRP_MAC_NRF_TX_FLOW_CTRL_BASED_ON_MDM_TX_DLC_REQS
	bool "Enable TX flow control"
	default y
	help
	  Enable TX window based flow ctrl on unacked mdm TX DLC data requests.

config DECT_NRP_MAC_NRF_CTRL_THREAD_STACK_SIZE
	int "Driver's internal ctrl thread stack size"
	default 3072
	help
	  This option sets the driver's stack size for its internal ctrl thread.
	  Note: most probably this could be deacreased if size of net mgmt events are decreased.

config DECT_NRP_MAC_NRF_RX_THREAD_STACK_SIZE
	int "Driver's internal RX thread stack size"
	default 3072
	help
	  This option sets the driver's stack size for its internal RX thread.

endif # DECT_NRP_MAC_NRF

endmenu
```

## samples/dect/dect_mac/dect_rpc_android_shell/sample.yaml
```yaml
sample:
  name: DECT RPC Android Shell
  description: |
    Android terminal/shell application for remotely controlling and monitoring
    DECT NR+ devices via nRF Cloud MQTT RPC. Provides a command-line interface
    for DECT RPC operations from Android devices.
  type: application
  tags:
    - android
    - csharp
    - dect
    - rpc
    - mqtt
    - nrf-cloud
    - terminal
    - shell
```

## samples/dect/dect_mac/dect_shell/src/native_tls/Kconfig
```kconfig
#
# Copyright (c) 2025 Nordic Semiconductor ASA
#
# SPDX-License-Identifier: LicenseRef-Nordic-5-Clause

config DESH_NATIVE_TLS
	bool "Custom AT%CMNG command to store credentials for native TLS to settings"
	depends on SETTINGS
	default n
	select AT_CMD_CUSTOM
	help
	  Enable custom AT%CMNG command to store TLS credentials to settings
	  for native TLS usage.
	  When enabled, the AT%CMNG command can be used to store TLS credentials
	  (CA certificate, client certificate, private key) to the settings
	  storage, from where native TLS (Mbed TLS) can load them when
	  establishing a TLS connection.
	  Note: This feature requires SETTINGS to be enabled and as a default in desh, settings
	  is unsecured storage, this feature should not be used in production
	  devices without adding additional security to protect the
	  stored credentials.

if DESH_NATIVE_TLS

config DESH_NATIVE_TLS_CREDENTIAL_BUFFER_SIZE
	int "Buffer space reserved for loading credentials"
	default 4096
	help
	  Buffer space available for a single sec_tag when loading credentials for Mbed TLS.

config DESH_NATIVE_TLS_CREDENTIAL_BUFFER_COUNT
	int "Amount of buffers for loading credentials"
	default 1
	range 1 2
	help
	  Amount of buffers available for loading sec_tag credentials for Mbed TLS.
	  TLS client needs the buffer only when connecting whereas TLS server needs the buffer as long as it is running.
	  Increase the value, if you need TLS client and server running simultaneously with different sec_tags.

endif
```

## samples/dect/dect_rpc/sample.yaml
```yaml
# Copyright (c) 2026 Nordic Semiconductor ASA
# SPDX-License-Identifier: LicenseRef-Nordic-5-Clause

sample:
  name: DECT NR+ net_if on external MCU (experimental)
  description: Experimental DECT NR+ RPC — Zephyr net_if on an external MCU, modem and stack on nRF91
common:
  tags:
    - ci_build
    - sysbuild
    - ci_samples_dect
  sysbuild: true
  build_only: true
  integration_platforms:
    - nrf54l15dk/nrf54l15/cpuapp
    - nrf9151dk/nrf9151/ns
  platform_allow:
    - nrf54l15dk/nrf54l15/cpuapp
    - nrf9151dk/nrf9151/ns

tests:
  sample.dect.dect_rpc.server:
    platform_allow:
      - nrf9151dk/nrf9151/ns
    extra_args:
      - EXTRA_CONF_FILE=server.conf
      - EXTRA_DTC_OVERLAY_FILE=overlay-nrf9151-server-modem.overlay
  sample.dect.dect_rpc.client:
    platform_allow:
      - nrf54l15dk/nrf54l15/cpuapp
  sample.dect.dect_rpc.client.iperf3_tx:
    platform_allow:
      - nrf54l15dk/nrf54l15/cpuapp
    extra_args: EXTRA_CONF_FILE="iperf3-common.conf;iperf3-tx.conf"
  sample.dect.dect_rpc.client.ping_dns:
    platform_allow:
      - nrf54l15dk/nrf54l15/cpuapp
    extra_args: EXTRA_CONF_FILE="ping.conf;dns.conf"
  sample.dect.dect_rpc.client.nrf9151:
    platform_allow:
      - nrf9151dk/nrf9151/ns
```

## samples/dect/dect_shell/Kconfig
```kconfig
#
# Copyright (c) 2026 Nordic Semiconductor ASA
#
# SPDX-License-Identifier: LicenseRef-Nordic-5-Clause
#

menu "DECT NR+ Shell config"

config SAMPLE_DESH_PRINT_BUFFER_SIZE
	int "Buffer size used when printing shell output"
	default 1024
	help
	  If the printed string exceeds this buffer, an error message is printed
	  first, and then the requested string is cut into the length of this buffer.

config SAMPLE_DESH_COMMON_WORKQ_STACK_SIZE
	int "Common workqueue stack size"
	default 3072

config SAMPLE_DESH_DECT_ICMP_PING
	bool "ICMP ping support"
	depends on NET_SOCKETS_INET_RAW
	default y
	help
	  Support for ICMP ping.

config SAMPLE_DESH_IPERF3
	bool "iPerf3"
	select NRF_IPERF3

config SAMPLE_DESH_CLOUD_MQTT
	bool "MQTT connection to nRF Cloud"
	depends on NRF_CLOUD_MQTT
	help
	  MQTT connection to nRF Cloud.

config SAMPLE_DESH_CLOUD_COAP
	bool "CoAP connection to nRF Cloud"
	depends on NRF_CLOUD_COAP
	help
	  CoAP connection to nRF Cloud.

config DECT_SHELL_MDNS_DNS_SD_ADVERTISE
	bool "Advertise _dect-nr._udp on dect0 (DNS-SD stub socket)"
	default n
	depends on MDNS_RESPONDER_DNS_SD
	help
	  When enabled, the sample binds a UDP socket on the DECT interface and registers
	  an mDNS DNS-SD record for _dect-nr._udp so peers and tools (for example avahi-browse)
	  can discover this device. Zephyr only treats the service as valid when the advertised
	  port is bound; datagrams on that port are discarded. The instance name follows
	  net_hostname_get() (hostname shell / settings), truncated per DNS-SD label rules.
	  Disable to save resources when you do not need to be discoverable via DNS-SD.
	  For mDNS/DNS-SD, merge mdns-common.conf and mdns-discover.conf in the sample.
	  Tune DECT_MDM_NRF_RX_MSGQ_SIZE / DECT_MDM_NRF_RX_EVENT_POOL_COUNT if you see
	  RX queue or event-pool exhaustion under mDNS bursts.

if DECT_SHELL_MDNS_DNS_SD_ADVERTISE

config DECT_SHELL_MDNS_DNS_SD_PORT
	int "UDP port for mDNS DNS-SD stub socket"
	default 4700
	range 1 65535
	help
	  UDP port bound on dect0 for DNS-SD port-in-use checks. Must match the port pointer
	  in the registered dns_sd_rec.

endif # DECT_SHELL_MDNS_DNS_SD_ADVERTISE

config DECT_SHELL_MDNS_DISCOVER
	bool "desh: dect discover (mDNS DNS-SD browse on DECT)"
	depends on MDNS_RESOLVER
	default n
	help
	  Enables the ``dect discover`` shell command: PTR browse for _dect-nr._udp on
	  the mesh, then AAAA resolution per host. Requires the mDNS
	  resolver. Enable together with mDNS/DNS-SD stack options (see mdns-discover.conf)
	  when you need peer discovery on the mesh.

config SAMPLE_DESH_L2_SHELL
	bool "DECT NR+ Shell for nRF91 Modem MAC"
	default y
	select DECT_L2_SHELL_LIB
	help
	  Enable support for DECT NR+ Net Management interface.
	  This selects the DECT MAC L2 shell library.

menuconfig SAMPLE_DESH_AUTO_CONNECT
	bool "Auto-connect command"
	default y
	help
	  Build the "auto_connect" shell command and its event-driven worker
	  that joins (PT) or creates (FT) the DECT NR+ network automatically
	  once the configured trigger conditions are met. The runtime state is
	  persisted through the Zephyr settings subsystem.

	  Disable to drop both auto_connect.c and auto_connect_shell.c from the
	  build when the sample only needs manual network bring-up.

if SAMPLE_DESH_AUTO_CONNECT

config SAMPLE_DESH_AUTO_CONNECT_DEFAULT_ENABLED
	bool "Enable auto-connect by default"
	default n
	help
	  Initial value of the auto-connect setting at first boot, used until
	  the user overrides it via the "auto_connect enable|disable" shell
	  commands. The override is persisted through the Zephyr settings
	  subsystem and wins over this default on subsequent boots.

	  When enabled, the sample joins (PT) or creates (FT) the DECT NR+
	  network automatically once the trigger conditions are met
	  (see SAMPLE_DESH_AUTO_CONNECT_DEFAULT_DELAY_SECS).

config SAMPLE_DESH_AUTO_CONNECT_DEFAULT_DELAY_SECS
	int "Auto-connect delay (seconds)"
	default 0
	range 0 86400
	help
	  Initial auto-connect delay used at first boot, until the user
	  overrides it via "auto_connect delay <seconds>". The override is
	  persisted through the Zephyr settings subsystem and wins over this
	  default on subsequent boots.

	  0 selects the default trigger: when CONFIG_NET_CONNECTION_MANAGER is
	  enabled, auto_connect waits for both NET_EVENT_DECT_ACTIVATE_DONE and
	  NET_EVENT_L4_CONNECTED before firing; otherwise it fires as soon as
	  NET_EVENT_DECT_ACTIVATE_DONE arrives.

	  A non-zero value overrides the default trigger and schedules the
	  auto-connect work that many seconds after NET_EVENT_DECT_ACTIVATE_DONE,
	  independent of L4 connectivity.

endif # SAMPLE_DESH_AUTO_CONNECT

rsource "Kconfig.native_tls"

endmenu # Nordic DECT NR+ Shell config

menu "Zephyr Kernel"
source "Kconfig.zephyr"
endmenu
```
